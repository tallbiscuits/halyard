// SPDX-License-Identifier: GPL-3.0-or-later
// Delivery-layer tests: metadata extraction, the library on a real directory, 8.3 names, and
// complete hand-offs against the simulated Marlin. Run: pio test -e native
#include <dirent.h>
#include <sys/stat.h>
#include <unistd.h>
#include <unity.h>

#include <algorithm>
#include <functional>
#include <memory>

#include "../test_link/fake_marlin.h"
#include "delivery.h"
#include "gcode_line.h"
#include "library.h"
#include "metadata.h"
#include "printer.h"

using namespace halyard;

// ---- helpers ----------------------------------------------------------------------------

static std::string g_root;

static std::string read_all(const std::string& path) {
  std::string out;
  FILE* f = fopen(path.c_str(), "rb");
  if (!f) return out;
  char buf[4096];
  size_t n;
  while ((n = fread(buf, 1, sizeof buf, f)) > 0) out.append(buf, n);
  fclose(f);
  return out;
}

static void write_all(const std::string& path, const std::string& data) {
  FILE* f = fopen(path.c_str(), "wb");
  fwrite(data.data(), 1, data.size(), f);
  fclose(f);
}

static bool exists(const std::string& path) {
  struct stat st;
  return stat(path.c_str(), &st) == 0;
}

static void rm_tree(const std::string& path) {
  if (DIR* d = opendir(path.c_str())) {
    while (struct dirent* de = readdir(d)) {
      std::string n = de->d_name;
      if (n != "." && n != "..") rm_tree(path + "/" + n);
    }
    closedir(d);
    rmdir(path.c_str());
  } else {
    unlink(path.c_str());
  }
}

static std::string fixture(const char* name) {
  std::string here = __FILE__;
  std::string dir = here.substr(0, here.rfind('/'));
  std::string data = read_all(dir + "/../data/" + name);
  TEST_ASSERT_TRUE_MESSAGE(!data.empty(), "fixture missing");
  return data;
}

static Metadata parse_text(const std::string& text) {
  MetadataParser p;
  size_t pos = 0;
  while (pos < text.size()) {
    size_t e = text.find('\n', pos);
    if (e == std::string::npos) e = text.size();
    std::string l = text.substr(pos, e - pos);
    if (!l.empty() && l.back() == '\r') l.pop_back();
    p.line(l);
    pos = e + 1;
  }
  return p.finish();
}

// Stores `data` in the library in uneven chunks, as an HTTP body would arrive.
static void store(Library& lib, const std::string& name, const std::string& data) {
  std::string err;
  auto w = lib.create(name, err);
  TEST_ASSERT_NOT_NULL_MESSAGE(w.get(), err.c_str());
  size_t pos = 0, chunk = 1;
  while (pos < data.size()) {
    size_t n = std::min(chunk, data.size() - pos);
    TEST_ASSERT_TRUE(w->write((const uint8_t*)data.data() + pos, n));
    pos += n;
    chunk = chunk * 3 % 1439 + 1;
  }
  TEST_ASSERT_TRUE_MESSAGE(w->finish(err), err.c_str());
}

// What Marlin will hold after an M28 upload of `data`.
static std::string expected_on_printer(const std::string& data) {
  std::string all, clean;
  size_t pos = 0;
  while (pos < data.size()) {
    size_t e = data.find('\n', pos);
    if (e == std::string::npos) e = data.size();
    std::string l = data.substr(pos, e - pos);
    pos = e + 1;
    if (!l.empty() && l.back() == '\r') l.pop_back();
    TEST_ASSERT_NULL(sanitize_for_upload(l, clean));
    if (!clean.empty()) all += clean + "\r\n";
  }
  return all;
}

// A harmless job: M117 and G4 only, with the temperatures a slicer would note in comments.
static std::string harmless_job(int seconds, int hotend = 0, int bed = 0) {
  std::string s = "; generated by PrusaSlicer 2.8.1+linux on 2026-09-26 at 10:00:00 UTC\n";
  for (int i = 0; i < seconds; i++)
    s += "M117 step " + std::to_string(i) + "\nG4 S1 ; wait\n";
  s += "; estimated printing time (normal mode) = " + std::to_string(seconds) + "s\n";
  if (hotend) s += "; first_layer_temperature = " + std::to_string(hotend) + "\n";
  if (bed) s += "; first_layer_bed_temperature = " + std::to_string(bed) + "\n";
  return s;
}

struct Rig {
  FakeMarlin m;
  FakeTransport t{m};
  Link link;
  Printer printer;
  Library lib;
  Delivery delivery;
  uint32_t now = 1;
  std::vector<std::string> events;

  explicit Rig(FakeMarlin::Options o = {})
      : link(t), printer(link), lib(g_root), delivery(printer, lib) {
    m.opt = o;
    TEST_ASSERT_TRUE(lib.begin());
    printer.on_event = [this](const std::string& e) { events.push_back(e); };
    delivery.on_event = [this](const std::string& e) { events.push_back(e); };
  }
  void step() {
    printer.poll(now);
    delivery.poll(now);
    m.tick(now);
    now++;
  }
  bool run_until(const std::function<bool()>& cond, uint32_t max_ms) {
    for (uint32_t i = 0; i < max_ms; i++) {
      if (cond()) return true;
      step();
    }
    return cond();
  }
  void ready() {
    TEST_ASSERT_TRUE(run_until([&] { return printer.status().job == Job::Idle; }, 10000));
  }
  // Runs a hand-off to the end; returns "OK: msg" or "FAIL: msg".
  std::string hand_off(const std::string& name, bool print, uint32_t max_ms = 300000) {
    bool done = false;
    std::string msg, err;
    if (!delivery.start(name, print,
                        [&](bool ok, const std::string& m2) {
                          done = true;
                          msg = (ok ? "OK: " : "FAIL: ") + m2;
                        },
                        err))
      return "REFUSED: " + err;
    if (!run_until([&] { return done; }, max_ms)) return "FAIL: timed out";
    return msg;
  }
  size_t count_executed(const std::string& prefix) const {
    size_t n = 0;
    for (auto& e : m.executed) n += starts_with(e, prefix.c_str());
    return n;
  }
  long index_of(const std::string& prefix) const {
    for (size_t i = 0; i < m.executed.size(); i++)
      if (starts_with(m.executed[i], prefix.c_str())) return (long)i;
    return -1;
  }
};

static void assert_starts(const char* prefix, const std::string& s) {
  TEST_ASSERT_TRUE_MESSAGE(starts_with(s, prefix), s.c_str());
}

void setUp() {
  char tmpl[] = "/tmp/halyard-test-XXXXXX";
  TEST_ASSERT_NOT_NULL(mkdtemp(tmpl));
  g_root = tmpl;
}

void tearDown() { rm_tree(g_root); }

// ---- metadata ---------------------------------------------------------------------------

void test_parse_duration() {
  TEST_ASSERT_EQUAL_FLOAT(8206, parse_duration("2h 16m 46s"));
  TEST_ASSERT_EQUAL_FLOAT(48, parse_duration("48s"));
  TEST_ASSERT_EQUAL_FLOAT(90061, parse_duration("1d 1h 1m 1s"));
  TEST_ASSERT_EQUAL_FLOAT(-1, parse_duration("soon"));
}

void test_metadata_orca() {
  Metadata m = parse_text(fixture("orca_phone_stand.gc"));
  TEST_ASSERT_EQUAL_STRING("OrcaSlicer", m.slicer.c_str());
  TEST_ASSERT_EQUAL_STRING("2.4.2", m.slicer_version.c_str());
  TEST_ASSERT_EQUAL_FLOAT(8206, m.estimated_time);
  TEST_ASSERT_EQUAL_FLOAT(8748.65, m.filament_total);
  TEST_ASSERT_EQUAL_FLOAT(26.09, m.filament_weight_total);
  TEST_ASSERT_EQUAL_FLOAT(0.2, m.layer_height);
  TEST_ASSERT_EQUAL_FLOAT(0.2, m.first_layer_height);
  TEST_ASSERT_EQUAL_FLOAT(57, m.object_height);
  TEST_ASSERT_EQUAL_FLOAT(220, m.first_layer_extr_temp);
  TEST_ASSERT_EQUAL_FLOAT(55, m.first_layer_bed_temp);
  TEST_ASSERT_EQUAL(285, m.layer_count);
  TEST_ASSERT_EQUAL(0, m.thumbnails.size());
}

void test_metadata_cura_falls_back_to_commands() {
  Metadata m = parse_text(
      ";FLAVOR:Marlin\n;TIME:6000\n;Filament used: 1.5m\n;Layer height: 0.2\n;MINZ:0.2\n"
      ";MAXZ:10.2\n;LAYER_COUNT:51\n;Generated with Cura_SteamEngine 5.4.0\n"
      "M140 S60\nM105\nM190 S60\nM104 S200 ; nozzle\nM109 S200\nG28\n;LAYER:0\n");
  TEST_ASSERT_EQUAL_STRING("Cura", m.slicer.c_str());
  TEST_ASSERT_EQUAL_STRING("5.4.0", m.slicer_version.c_str());
  TEST_ASSERT_EQUAL_FLOAT(6000, m.estimated_time);
  TEST_ASSERT_EQUAL_FLOAT(1500, m.filament_total);
  TEST_ASSERT_EQUAL_FLOAT(0.2, m.first_layer_height);
  TEST_ASSERT_EQUAL_FLOAT(10.2, m.object_height);
  TEST_ASSERT_EQUAL(51, m.layer_count);
  TEST_ASSERT_EQUAL_FLOAT(200, m.first_layer_extr_temp);
  TEST_ASSERT_EQUAL_FLOAT(60, m.first_layer_bed_temp);
}

void test_metadata_comment_temps_beat_commands() {
  // Slic3r-family slicers note temperatures at the end; those win over the start G-code,
  // which often begins with a lower "no ooze" temperature.
  Metadata m = parse_text("M104 S150\nM140 S55\n; first_layer_temperature = 215,205\n");
  TEST_ASSERT_EQUAL_FLOAT(215, m.first_layer_extr_temp);
  TEST_ASSERT_EQUAL_FLOAT(55, m.first_layer_bed_temp);
}

static const std::string kPng = std::string("\x89PNG\r\n\x1a\n\0\0\0\rIHDR tiny", 21);
static const std::string kPngB64 = "iVBORw0KGgoAAAANSUhEUiB0aW55";

static std::string prusa_with_thumbnails() {
  return "; generated by PrusaSlicer 2.8.1+linux-x64 on 2026-09-26 at 10:00:00 UTC\n"
         ";\n; thumbnail begin 16x16 28\n; " + kPngB64.substr(0, 16) + "\n; " +
         kPngB64.substr(16) + "\n; thumbnail end\n;\n"
         "; thumbnail_QOI begin 32x32 8\n; cW9pZg==\n; thumbnail_QOI end\n"
         "; thumbnail begin 300x300 40\n; not base64 at all!\n; thumbnail end\n"
         "; thumbnail begin 220x124 28\n; " + kPngB64 + "\n; thumbnail end\n"
         "G28\nG1 X10 Y10 ; move\n"
         "; estimated printing time (normal mode) = 1h 2m 3s\n"
         "; filament used [mm] = 100.5, 20.5\n; filament used [g] = 3.1\n"
         "; total filament used [g] = 4.2\n; layer_height = 0.15\n"
         "; first_layer_height = 0.2\n; max_layer_z = 12.35\n";
}

void test_library_stores_metadata_and_thumbnails() {
  Library lib(g_root);
  TEST_ASSERT_TRUE(lib.begin());
  store(lib, "Benchy v2.gcode", prusa_with_thumbnails());
  LibraryEntry e;
  TEST_ASSERT_TRUE(lib.get("Benchy v2.gcode", e));
  TEST_ASSERT_EQUAL(prusa_with_thumbnails().size(), e.size);
  TEST_ASSERT_EQUAL_STRING("PrusaSlicer", e.meta.slicer.c_str());
  TEST_ASSERT_EQUAL_STRING("2.8.1+linux-x64", e.meta.slicer_version.c_str());
  TEST_ASSERT_EQUAL_FLOAT(3723, e.meta.estimated_time);
  TEST_ASSERT_EQUAL_FLOAT(121, e.meta.filament_total);
  TEST_ASSERT_EQUAL_FLOAT(4.2, e.meta.filament_weight_total);
  TEST_ASSERT_EQUAL_FLOAT(12.35, e.meta.object_height);
  TEST_ASSERT_EQUAL_FLOAT(-1, e.meta.first_layer_extr_temp);
  // The QOI block is skipped, the broken PNG block dropped along with its file.
  TEST_ASSERT_EQUAL(2, e.meta.thumbnails.size());
  const Thumbnail& t = e.meta.thumbnails[1];
  TEST_ASSERT_EQUAL(220, t.width);
  TEST_ASSERT_EQUAL(124, t.height);
  TEST_ASSERT_EQUAL(kPng.size(), t.size);
  TEST_ASSERT_EQUAL_STRING(".thumbs/Benchy v2-220x124.png", t.relative_path.c_str());
  TEST_ASSERT_TRUE(read_all(g_root + "/" + t.relative_path) == kPng);
  TEST_ASSERT_TRUE(read_all(g_root + "/" + e.meta.thumbnails[0].relative_path) == kPng);
  TEST_ASSERT_FALSE(exists(g_root + "/.thumbs/Benchy v2-300x300.png"));

  // Survives a reload from its .meta file.
  Library again(g_root);
  LibraryEntry e2;
  TEST_ASSERT_TRUE(again.get("Benchy v2.gcode", e2));
  TEST_ASSERT_EQUAL_STRING(e.meta.serialize().c_str(), e2.meta.serialize().c_str());

  // Remove takes the thumbnails and metadata with it.
  TEST_ASSERT_TRUE(lib.remove("Benchy v2.gcode"));
  TEST_ASSERT_EQUAL(0, lib.names().size());
  TEST_ASSERT_FALSE(exists(g_root + "/" + t.relative_path));
  TEST_ASSERT_FALSE(exists(g_root + "/.meta/Benchy v2.gcode.meta"));
}

void test_library_partial_write_is_invisible_and_abort_cleans_up() {
  Library lib(g_root);
  TEST_ASSERT_TRUE(lib.begin());
  std::string err, data = prusa_with_thumbnails();
  auto w = lib.create("half.gcode", err);
  TEST_ASSERT_TRUE(w->write((const uint8_t*)data.data(), data.size() / 2));
  TEST_ASSERT_EQUAL(0, lib.names().size());
  w->abort();
  TEST_ASSERT_EQUAL(0, lib.names().size());
  TEST_ASSERT_FALSE(exists(g_root + "/half.gcode.part"));
  TEST_ASSERT_FALSE(exists(g_root + "/.thumbs/half-16x16.png"));
  // A writer destroyed without finish() aborts too.
  { auto w2 = lib.create("gone.gcode", err); }
  TEST_ASSERT_FALSE(exists(g_root + "/gone.gcode.part"));
  TEST_ASSERT_NULL(lib.create("../escape.gcode", err).get());
  TEST_ASSERT_NULL(lib.create(".hidden", err).get());
}

void test_library_scans_file_copied_by_hand() {
  Library lib(g_root);
  TEST_ASSERT_TRUE(lib.begin());
  write_all(g_root + "/copied.gcode", fixture("orca_phone_stand.gc"));
  std::vector<std::string> names = lib.names();
  TEST_ASSERT_EQUAL(1, names.size());
  LibraryEntry e;
  TEST_ASSERT_TRUE(lib.get("copied.gcode", e));
  TEST_ASSERT_EQUAL_FLOAT(8206, e.meta.estimated_time);
  TEST_ASSERT_TRUE(exists(g_root + "/.meta/copied.gcode.meta"));
}

void test_file_line_source() {
  std::string long_comment(10000, 'x');
  write_all(g_root + "/f.gcode", "G1 X1\r\n; " + long_comment + "\nM117 hi ;" + long_comment +
                                     "\n\nG4 S1");
  FILE* f = fopen((g_root + "/f.gcode").c_str(), "rb");
  FileLineSource src(f, 0);
  std::string l;
  TEST_ASSERT_TRUE(src.next(l));
  TEST_ASSERT_EQUAL_STRING("G1 X1", l.c_str());
  TEST_ASSERT_TRUE(src.next(l));
  TEST_ASSERT_TRUE(l.size() < 300);  // a long comment is cut, not held whole
  TEST_ASSERT_TRUE(src.next(l));
  assert_starts("M117 hi ;xxx", l);
  TEST_ASSERT_TRUE(src.next(l));
  TEST_ASSERT_EQUAL_STRING("", l.c_str());
  TEST_ASSERT_TRUE(src.next(l));
  TEST_ASSERT_EQUAL_STRING("G4 S1", l.c_str());
  TEST_ASSERT_FALSE(src.next(l));
}

void test_short_names() {
  TEST_ASSERT_EQUAL_STRING("PHONES~1.GCO", short_name("Phone_Stand_02_PLA_2h17m.gcode", {}).c_str());
  TEST_ASSERT_EQUAL_STRING("PHONES~2.GCO",
                           short_name("Phone_Stand.gcode", {"PHONES~1.GCO"}).c_str());
  TEST_ASSERT_EQUAL_STRING("JOB~1.GCO", short_name("___.gcode", {}).c_str());
  TEST_ASSERT_EQUAL_STRING("AB~1.GCO", short_name("a b", {}).c_str());
  std::vector<std::string> taken;
  for (int i = 1; i <= 9; i++) taken.push_back("PHONES~" + std::to_string(i) + ".GCO");
  TEST_ASSERT_EQUAL_STRING("PHONE~10.GCO", short_name("phone stand.gcode", taken).c_str());
}

// ---- hand-off ---------------------------------------------------------------------------

static void handoff_and_print(FakeMarlin::Options o) {
  Rig r(o);
  std::string data = harmless_job(3, 215, 60);
  store(r.lib, "Phone Stand v2.gcode", data);
  r.ready();
  std::string res = r.hand_off("Phone Stand v2.gcode", true);
  assert_starts("OK: printing Phone Stand v2.gcode (PHONES~1.GCO)", res);
  TEST_ASSERT_TRUE(r.m.files["PHONES~1.GCO"] == expected_on_printer(data));
  // Preheat before the transfer; the print is started with the 8.3 name.
  TEST_ASSERT_TRUE(r.index_of("M140 S60") >= 0);
  TEST_ASSERT_TRUE(r.index_of("M104 S215") >= 0);
  TEST_ASSERT_TRUE(r.index_of("M140 S60") < r.index_of("M28 PHONES~1.GCO"));
  TEST_ASSERT_TRUE(r.index_of("M23 PHONES~1.GCO") > r.index_of("M28 PHONES~1.GCO"));
  TEST_ASSERT_EQUAL(215, r.m.hotend_target);
  TEST_ASSERT_EQUAL(Job::Printing, r.printer.status().job);
  LibraryEntry e;
  TEST_ASSERT_TRUE(r.lib.get("Phone Stand v2.gcode", e));
  TEST_ASSERT_EQUAL_STRING("PHONES~1.GCO", e.printer_name.c_str());
  TEST_ASSERT_EQUAL(r.m.files["PHONES~1.GCO"].size(), e.printer_size);
  TEST_ASSERT_TRUE(r.run_until([&] { return r.printer.status().job == Job::Idle; }, 60000));
}

void test_handoff_and_print_full() { handoff_and_print({}); }

void test_handoff_and_print_minimal() {
  FakeMarlin::Options o;
  o.advanced_ok = o.emergency_parser = o.autoreport_temp = o.autoreport_sd = false;
  o.long_filename = o.keepalive = false;
  o.baud = 115200;
  o.rx_size = 128;
  handoff_and_print(o);
}

void test_handoff_and_print_stock() { handoff_and_print(FakeMarlin::stock()); }

void test_real_slicer_file_hands_off() {
  Rig r;
  store(r.lib, "Phone_Stand_02_PLA_2h17m.gcode", fixture("orca_phone_stand.gc"));
  r.ready();
  std::string res = r.hand_off("Phone_Stand_02_PLA_2h17m.gcode", false);
  assert_starts("OK: on the printer's card as PHONES~1.GCO", res);
  TEST_ASSERT_TRUE(r.m.files["PHONES~1.GCO"] == expected_on_printer(fixture("orca_phone_stand.gc")));
  // Hand-off without print: no heat, no start.
  TEST_ASSERT_EQUAL(-1, r.index_of("M104 S2"));
  TEST_ASSERT_EQUAL(-1, r.index_of("M23"));
}

void test_real_slicer_file_binary() {
  // The full firmware's path: M28 B1, compressed. The printer's copy is the same bytes the
  // ASCII path writes, so sizes, the copy check and printing do not care which ran.
  FakeMarlin::Options o;
  o.binary = true;
  Rig r(o);
  store(r.lib, "Phone_Stand_02_PLA_2h17m.gcode", fixture("orca_phone_stand.gc"));
  r.ready();
  std::string res = r.hand_off("Phone_Stand_02_PLA_2h17m.gcode", false);
  assert_starts("OK: on the printer's card as PHONES~1.GCO", res);
  TEST_ASSERT_TRUE(r.m.files["PHONES~1.GCO"] == expected_on_printer(fixture("orca_phone_stand.gc")));
  bool binary = false;
  for (auto& e : r.events) binary |= e.find("binary, compressed") != std::string::npos;
  TEST_ASSERT_TRUE(binary);
  TEST_ASSERT_FALSE(r.m.binary_mode);
  assert_starts("OK: printing", r.hand_off("Phone_Stand_02_PLA_2h17m.gcode", true));
}

void test_released_card_is_mounted_again() {
  // Halyard restarted after a binary transfer and before its M21: the printer's card is
  // released. The hand-off's M20 says "No media"; the printer is idle, so it mounts it.
  Rig r;
  r.m.mounted = false;
  store(r.lib, "job.gcode", harmless_job(1));
  r.ready();
  assert_starts("OK: on the printer's card as JOB~1.GCO", r.hand_off("job.gcode", false));
  TEST_ASSERT_TRUE(r.m.mounted);
  TEST_ASSERT_TRUE(r.index_of("M21") >= 0);
}

void test_second_handoff_uses_printer_copy() {
  Rig r;
  store(r.lib, "job.gcode", harmless_job(2));
  r.ready();
  assert_starts("OK:", r.hand_off("job.gcode", false));
  TEST_ASSERT_EQUAL(1, r.count_executed("M28"));
  assert_starts("OK: printing job.gcode (JOB~1.GCO)", r.hand_off("job.gcode", true));
  TEST_ASSERT_EQUAL(1, r.count_executed("M28"));  // not written again

  // Replacing the file on Halyard makes the printer's copy stale: same name, written again.
  TEST_ASSERT_TRUE(r.run_until([&] { return r.printer.status().job == Job::Idle; }, 60000));
  store(r.lib, "job.gcode", harmless_job(4));
  assert_starts("OK:", r.hand_off("job.gcode", false));
  TEST_ASSERT_EQUAL(2, r.count_executed("M28 JOB~1.GCO"));
  TEST_ASSERT_TRUE(r.m.files["JOB~1.GCO"] == expected_on_printer(harmless_job(4)));
}

void test_name_clash_with_foreign_file() {
  Rig r;
  r.m.files["PHONES~1.GCO"] = "M117 not ours\r\n";
  store(r.lib, "phone stand.gcode", harmless_job(1));
  store(r.lib, "PHONE-STAND.gcode", harmless_job(2));
  r.ready();
  assert_starts("OK: on the printer's card as PHONES~2.GCO", r.hand_off("phone stand.gcode", false));
  assert_starts("OK: on the printer's card as PHONES~3.GCO", r.hand_off("PHONE-STAND.gcode", false));
  TEST_ASSERT_TRUE(r.m.files["PHONES~1.GCO"] == "M117 not ours\r\n");

  // Someone deletes PHONES~2 on the printer; the file keeps its name, and no other file
  // takes a name a library file owns.
  r.m.files.erase("PHONES~2.GCO");
  store(r.lib, "phone stand 3.gcode", harmless_job(1));
  assert_starts("OK: on the printer's card as PHONES~4.GCO", r.hand_off("phone stand 3.gcode", false));
  assert_starts("OK: on the printer's card as PHONES~2.GCO", r.hand_off("phone stand.gcode", false));
}

void test_upload_during_print_then_handoff() {
  // A file arrives while the printer prints; the hand-off is refused until the print ends,
  // then goes through on command.
  Rig r;
  r.m.files["FIRST.GCO"] = expected_on_printer(harmless_job(5));
  r.ready();
  bool started = false;
  r.printer.start_print("FIRST.GCO", [&](bool ok, const std::string&) { started = ok; });
  TEST_ASSERT_TRUE(r.run_until([&] { return started; }, 5000));
  r.step();
  store(r.lib, "second.gcode", harmless_job(2));
  std::string res = r.hand_off("second.gcode", true);
  assert_starts("REFUSED: printer is printing", res);
  TEST_ASSERT_EQUAL(0, r.count_executed("M28"));
  TEST_ASSERT_TRUE(r.run_until([&] { return r.printer.status().job == Job::Idle; }, 60000));
  assert_starts("OK: printing second.gcode (SECOND~1.GCO)", r.hand_off("second.gcode", true));
}

void test_failed_open_switches_heaters_off() {
  Rig r;
  store(r.lib, "hot.gcode", harmless_job(1, 210, 60));
  r.ready();
  r.m.fail_open = true;
  std::string res = r.hand_off("hot.gcode", true);
  assert_starts("FAIL: upload failed: M28 failed", res);
  TEST_ASSERT_TRUE_MESSAGE(res.find("heaters switched off") != std::string::npos, res.c_str());
  TEST_ASSERT_TRUE(r.run_until([&] { return r.link.idle(); }, 5000));
  TEST_ASSERT_EQUAL(0, r.m.hotend_target);
  TEST_ASSERT_EQUAL(0, r.m.bed_target);
  TEST_ASSERT_EQUAL(-1, r.index_of("M23"));
}

void test_abort_mid_upload() {
  Rig r;
  store(r.lib, "long.gcode", harmless_job(400, 200, 50));
  r.ready();
  bool done = false;
  std::string msg, err;
  TEST_ASSERT_TRUE(r.delivery.start("long.gcode", true,
                                    [&](bool ok, const std::string& m2) {
                                      done = true;
                                      msg = (ok ? "OK: " : "FAIL: ") + m2;
                                    },
                                    err));
  TEST_ASSERT_TRUE(r.run_until([&] { return r.delivery.progress().bytes > 2000; }, 60000));
  TEST_ASSERT_EQUAL_STRING("uploading", r.delivery.progress().step);
  r.delivery.abort();
  TEST_ASSERT_TRUE(r.run_until([&] { return done; }, 30000));
  assert_starts("FAIL: upload failed: aborted; partial file deleted", msg);
  TEST_ASSERT_TRUE(r.run_until([&] { return r.link.idle(); }, 5000));
  TEST_ASSERT_EQUAL(0, r.m.files.count("LONG~1.GCO"));
  TEST_ASSERT_EQUAL(0, r.m.hotend_target);
  TEST_ASSERT_FALSE(r.delivery.busy());
}

void test_refusals() {
  Rig r;
  std::string err;
  auto noop = [](bool, const std::string&) {};
  TEST_ASSERT_FALSE(r.delivery.start("x.gcode", false, noop, err));  // state unknown
  r.ready();
  TEST_ASSERT_FALSE(r.delivery.start("missing.gcode", false, noop, err));
  assert_starts("no such file", err);
  store(r.lib, "a.gcode", harmless_job(1));
  TEST_ASSERT_TRUE(r.delivery.start("a.gcode", false, noop, err));
  TEST_ASSERT_FALSE(r.delivery.start("a.gcode", false, noop, err));
  assert_starts("a hand-off is already running", err);
}

int main() {
  UNITY_BEGIN();
  RUN_TEST(test_parse_duration);
  RUN_TEST(test_metadata_orca);
  RUN_TEST(test_metadata_cura_falls_back_to_commands);
  RUN_TEST(test_metadata_comment_temps_beat_commands);
  RUN_TEST(test_library_stores_metadata_and_thumbnails);
  RUN_TEST(test_library_partial_write_is_invisible_and_abort_cleans_up);
  RUN_TEST(test_library_scans_file_copied_by_hand);
  RUN_TEST(test_file_line_source);
  RUN_TEST(test_short_names);
  RUN_TEST(test_handoff_and_print_full);
  RUN_TEST(test_handoff_and_print_minimal);
  RUN_TEST(test_handoff_and_print_stock);
  RUN_TEST(test_real_slicer_file_hands_off);
  RUN_TEST(test_real_slicer_file_binary);
  RUN_TEST(test_released_card_is_mounted_again);
  RUN_TEST(test_second_handoff_uses_printer_copy);
  RUN_TEST(test_name_clash_with_foreign_file);
  RUN_TEST(test_upload_during_print_then_handoff);
  RUN_TEST(test_failed_open_switches_heaters_off);
  RUN_TEST(test_abort_mid_upload);
  RUN_TEST(test_refusals);
  return UNITY_END();
}
