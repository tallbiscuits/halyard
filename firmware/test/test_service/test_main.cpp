// SPDX-License-Identifier: GPL-3.0-or-later
// Service-layer tests: the Moonraker subset Mainsail uses and OctoPrint's upload, driven
// the way Mainsail and a slicer drive them, against the simulated Marlin. The websocket and
// HTTP server are the glue's; here messages go straight into Service. Run: pio test -e native
#include <ArduinoJson.h>
#include <dirent.h>
#include <sys/stat.h>
#include <unistd.h>
#include <unity.h>
#include <zlib.h>

#include <algorithm>
#include <cmath>
#include <functional>
#include <memory>

#include "../test_link/fake_marlin.h"
#include "delivery.h"
#include "gcode_line.h"
#include "library.h"
#include "multipart.h"
#include "printer.h"
#include "service.h"

using namespace halyard;

static std::string g_root;
static bool g_card = true;  // Halyard's card is mounted (Platform::card)
static float g_cpu_temp = 41.5f;  // Platform::cpu_temp; NAN: no reading

static void rm_tree(const std::string& path) {
  if (DIR* d = opendir(path.c_str())) {
    while (struct dirent* de = readdir(d)) {
      std::string n = de->d_name;
      if (n != "." && n != "..") rm_tree(path + "/" + n);
    }
    closedir(d);
    rmdir(path.c_str());
  } else {
    unlink(path.c_str());
  }
}

static bool exists(const std::string& path) {
  struct stat st;
  return stat(path.c_str(), &st) == 0;
}

void setUp() {
  g_cpu_temp = 41.5f;
  char tmpl[] = "/tmp/halyard-svc-XXXXXX";
  TEST_ASSERT_NOT_NULL(mkdtemp(tmpl));
  g_root = tmpl;
  mkdir((g_root + "/gcodes").c_str(), 0755);
}

void tearDown() { rm_tree(g_root); }

static JsonDocument parse(const std::string& s) {
  JsonDocument d;
  DeserializationError e = deserializeJson(d, s);
  TEST_ASSERT_FALSE_MESSAGE(e, s.c_str());
  return d;
}

static std::string harmless_job(int seconds, int hotend = 0, int bed = 0) {
  std::string s = "; generated by PrusaSlicer 2.8.1+linux on 2026-09-26 at 10:00:00 UTC\n";
  for (int i = 0; i < seconds; i++) s += "M117 step " + std::to_string(i) + "\nG4 S1\n";
  s += "; estimated printing time (normal mode) = " + std::to_string(seconds) + "s\n";
  if (hotend) s += "; first_layer_temperature = " + std::to_string(hotend) + "\n";
  if (bed) s += "; first_layer_bed_temperature = " + std::to_string(bed) + "\n";
  return s;
}

static const std::string kPngB64 = "iVBORw0KGgoAAAANSUhEUiB0aW55";

static std::string with_thumbnail(const std::string& job) {
  return "; thumbnail begin 16x16 28\n; " + kPngB64 + "\n; thumbnail end\n" + job;
}

// A multipart body the way browsers and slicers build it.
struct Form {
  std::string boundary = "----HalyardTestBoundary7MA4YWxkTrZu0gW";
  std::string body;
  Form& field(const std::string& name, const std::string& value) {
    body += "--" + boundary + "\r\nContent-Disposition: form-data; name=\"" + name + "\"\r\n\r\n" +
            value + "\r\n";
    return *this;
  }
  Form& file(const std::string& filename, const std::string& data) {
    body += "--" + boundary + "\r\nContent-Disposition: form-data; name=\"file\"; filename=\"" +
            filename + "\"\r\nContent-Type: application/octet-stream\r\n\r\n" + data + "\r\n";
    return *this;
  }
  std::string done() { return body + "--" + boundary + "--\r\n"; }
  std::string type() const { return "multipart/form-data; boundary=" + boundary; }
};

struct Rig {
  FakeMarlin m;
  FakeTransport t{m};
  Link link;
  Printer printer;
  Library lib;
  Delivery delivery;
  Service svc;
  uint32_t now = 1;
  int next_id = 1;
  std::vector<std::string> sent[16];  // per websocket connection, everything pushed to it
  bool rebooted = false;

  static Platform platform(bool* rebooted) {
    Platform p;
    p.wall_time = [] { return 1790000000.0; };
    p.disk = [](uint64_t& total, uint64_t& used) {
      total = 1000000;
      used = 250000;
      return true;
    };
    p.card = [] { return g_card; };
    p.free_memory = [] { return 200000u; };
    p.cpu_temp = [] { return g_cpu_temp; };
    p.os = "ESP-IDF v4.4.7, Arduino-ESP32 2.0.17";
    p.reboot = [rebooted] { *rebooted = true; };
    p.db_path = g_root + "/database.json";
    p.config_path = g_root + "/halyard.cfg";
    return p;
  }

  explicit Rig(FakeMarlin::Options o = {})
      : link(t), printer(link), lib(g_root + "/gcodes"), delivery(printer, lib),
        svc(link, printer, delivery, lib, platform(&rebooted)) {
    m.opt = o;
    TEST_ASSERT_TRUE(lib.begin());
    svc.begin();
    printer.on_line = [this](const std::string& l) { svc.printer_line(l); };
    delivery.on_event = [this](const std::string& e) { svc.delivery_event(e); };
  }
  void step() {
    printer.poll(now);
    delivery.poll(now);
    svc.poll(now);
    m.tick(now);
    drain();
    now++;
  }
  void drain() {
    int conn;
    std::string text;
    while (svc.take(conn, text)) sent[conn].push_back(text);
  }
  bool run_until(const std::function<bool()>& cond, uint32_t max_ms) {
    for (uint32_t i = 0; i < max_ms; i++) {
      if (cond()) return true;
      step();
    }
    return cond();
  }
  void ready() {
    TEST_ASSERT_TRUE(run_until([&] { return printer.status().job == Job::Idle; }, 10000));
    run_until([] { return false; }, 300);  // M211 and the first status push
  }
  // A JSON-RPC call over the websocket; returns the whole reply document.
  JsonDocument call(int conn, const std::string& method, const std::string& params = "{}") {
    int id = next_id++;
    std::string req = "{\"jsonrpc\":\"2.0\",\"method\":\"" + method + "\",\"params\":" + params +
                      ",\"id\":" + std::to_string(id) + "}";
    std::string r = svc.ws_message(conn, req);
    if (r.empty()) {  // a deferred reply: wait for it
      auto found = [&] {
        drain();
        for (auto& s : sent[conn])
          if (s.find("\"id\":" + std::to_string(id) + "}") != std::string::npos) return true;
        return false;
      };
      TEST_ASSERT_TRUE_MESSAGE(run_until(found, 60000), method.c_str());
      for (auto& s : sent[conn])
        if (s.find("\"id\":" + std::to_string(id) + "}") != std::string::npos) r = s;
    }
    return parse(r);
  }
  JsonDocument result(int conn, const std::string& method, const std::string& params = "{}") {
    JsonDocument d = call(conn, method, params);
    TEST_ASSERT_TRUE_MESSAGE(d["error"].isNull(), (method + ": " + d["error"]["message"].as<std::string>()).c_str());
    return d;
  }
  // The notifications of one kind pushed to a connection so far.
  std::vector<JsonDocument> notes(int conn, const std::string& method) {
    drain();
    std::vector<JsonDocument> out;
    for (auto& s : sent[conn]) {
      if (s.find("\"method\":\"" + method + "\"") == std::string::npos) continue;
      out.push_back(parse(s));
    }
    return out;
  }
  bool console_has(int conn, const std::string& text) {
    for (auto& n : notes(conn, "notify_gcode_response"))
      if (n["params"][0].as<std::string>().find(text) != std::string::npos) return true;
    return false;
  }
  HttpResponse upload(bool octoprint, const std::string& type, const std::string& body,
                      size_t chunk = 1000) {
    HttpResponse out;
    auto up = svc.upload(octoprint, type, out);
    if (!up) return out;
    for (size_t pos = 0; pos < body.size(); pos += chunk)
      if (!up->feed((const uint8_t*)body.data() + pos, std::min(chunk, body.size() - pos))) break;
    up->finish(out);
    return out;
  }
  size_t count_executed(const std::string& prefix) const {
    size_t n = 0;
    for (auto& e : m.executed) n += starts_with(e, prefix.c_str());
    return n;
  }
};

// ---- multipart -------------------------------------------------------------------------

struct Collect {
  std::vector<std::string> names, filenames, bodies;
  MultipartParser p;
  explicit Collect(const std::string& boundary) : p(boundary) {
    p.on_part = [this](const std::string& n, const std::string& f) {
      names.push_back(n);
      filenames.push_back(f);
      bodies.emplace_back();
      return true;
    };
    p.on_data = [this](const uint8_t* d, size_t n) {
      bodies.back().append((const char*)d, n);
      return true;
    };
  }
};

void test_multipart_any_chunking() {
  Form f;
  // Data that looks like a boundary, but is not one: no CRLF before it.
  std::string tricky = "G1 X1\r\n--" + f.boundary.substr(0, 10) + "\r\nM117 --" + f.boundary + "x\r\n\r";
  std::string body = "preamble\r\n" + f.field("print", "true").field("path", "").file("a \"b\".gcode", tricky).done();
  // Every chunk size from 1 byte to the whole body.
  for (size_t chunk = 1; chunk <= body.size(); chunk += chunk < 80 ? 1 : 97) {
    Collect c(f.boundary);
    for (size_t pos = 0; pos < body.size(); pos += chunk)
      TEST_ASSERT_TRUE(c.p.feed((const uint8_t*)body.data() + pos, std::min(chunk, body.size() - pos)));
    TEST_ASSERT_TRUE(c.p.done());
    TEST_ASSERT_EQUAL(3, c.names.size());
    TEST_ASSERT_EQUAL_STRING("print", c.names[0].c_str());
    TEST_ASSERT_EQUAL_STRING("true", c.bodies[0].c_str());
    TEST_ASSERT_EQUAL_STRING("", c.bodies[1].c_str());
    TEST_ASSERT_EQUAL_STRING("file", c.names[2].c_str());
    TEST_ASSERT_TRUE(c.bodies[2] == tricky);
  }
}

void test_multipart_boundary_and_errors() {
  std::string b;
  TEST_ASSERT_TRUE(MultipartParser::boundary_from("multipart/form-data; boundary=abc123", b));
  TEST_ASSERT_EQUAL_STRING("abc123", b.c_str());
  TEST_ASSERT_TRUE(MultipartParser::boundary_from("Multipart/Form-Data; charset=x; boundary=\"q r\"", b));
  TEST_ASSERT_EQUAL_STRING("q r", b.c_str());
  TEST_ASSERT_FALSE(MultipartParser::boundary_from("application/json", b));
  // A part with no Content-Disposition is an error.
  MultipartParser p("xx");
  std::string bad = "--xx\r\nContent-Type: text/plain\r\n\r\nhi\r\n--xx--\r\n";
  TEST_ASSERT_FALSE(p.feed((const uint8_t*)bad.data(), bad.size()));
  // A callback can stop it.
  MultipartParser q("xx");
  q.on_part = [](const std::string&, const std::string&) { return false; };
  std::string ok = "--xx\r\nContent-Disposition: form-data; name=\"a\"\r\n\r\n1\r\n--xx--";
  TEST_ASSERT_FALSE(q.feed((const uint8_t*)ok.data(), ok.size()));
}

// ---- Mainsail's first load -------------------------------------------------------------

void test_mainsail_init_sequence() {
  Rig r;
  r.svc.ws_open(1);
  r.ready();
  JsonDocument id = r.result(1, "server.connection.identify",
                             "{\"client_name\":\"mainsail\",\"version\":\"2.19.0\",\"type\":\"web\","
                             "\"url\":\"https://github.com/mainsail-crew/mainsail\"}");
  TEST_ASSERT_EQUAL(1, id["result"]["connection_id"].as<int>());
  JsonDocument info = r.result(1, "server.info");
  TEST_ASSERT_EQUAL_STRING("ready", info["result"]["klippy_state"]);
  TEST_ASSERT_TRUE(info["result"]["klippy_connected"].as<bool>());
  // Must succeed, or Mainsail hangs at "Initializing".
  TEST_ASSERT_EQUAL(0, r.result(1, "server.webcams.list")["result"]["webcams"].size());
  for (const char* m : {"server.config", "machine.system_info", "machine.proc_stats",
                        "server.history.list", "server.history.totals", "machine.update.status",
                        "printer.info", "server.gcode_store", "server.temperature_store"})
    r.result(1, m);
  JsonDocument dir = r.result(1, "server.files.get_directory", "{\"path\":\"gcodes\"}");
  TEST_ASSERT_EQUAL(750000, dir["result"]["disk_usage"]["free"].as<long>());
  JsonDocument cfgdir = r.result(1, "server.files.get_directory", "{\"path\":\"config\"}");
  TEST_ASSERT_EQUAL(1, cfgdir["result"]["files"].size());  // no halyard.cfg yet: marlin.cfg
  TEST_ASSERT_EQUAL_STRING("marlin.cfg", cfgdir["result"]["files"][0]["filename"]);
  // A fresh database: Mainsail's namespace does not exist yet, and that is an error.
  JsonDocument db = r.call(1, "server.database.get_item", "{\"namespace\":\"mainsail\"}");
  TEST_ASSERT_EQUAL(404, db["error"]["code"].as<int>());
  // Console completion queries the gcode object, which is not listed.
  JsonDocument q = r.result(1, "printer.objects.query", "{\"objects\":{\"gcode\":[\"commands\"]}}");
  TEST_ASSERT_TRUE(q["result"]["status"]["gcode"]["commands"]["G28"]["help"].is<const char*>());
  // Subscribe to exactly what printer.objects.list says, as Mainsail does.
  JsonDocument list = r.result(1, "printer.objects.list");
  std::string objs = "{";
  for (JsonVariant o : list["result"]["objects"].as<JsonArray>())
    objs += std::string(objs.size() > 1 ? "," : "") + "\"" + o.as<std::string>() + "\":null";
  objs += "}";
  JsonDocument sub = r.result(1, "printer.objects.subscribe", "{\"objects\":" + objs + "}");
  JsonObject st = sub["result"]["status"];
  for (const char* o : {"webhooks", "print_stats", "virtual_sdcard", "extruder", "heater_bed",
                        "toolhead", "idle_timeout", "configfile", "heaters", "halyard"})
    TEST_ASSERT_TRUE_MESSAGE(st[o].is<JsonObject>(), o);
  TEST_ASSERT_EQUAL_STRING("ready", st["webhooks"]["state"]);
  TEST_ASSERT_EQUAL_STRING("standby", st["print_stats"]["state"]);
  TEST_ASSERT_EQUAL_STRING("idle", st["halyard"]["handoff"]["state"]);
  // M211 gave the printer's size (the fake reports a 235 x 235 x 250 volume).
  TEST_ASSERT_EQUAL_FLOAT(235, st["toolhead"]["axis_maximum"][0].as<float>());
  TEST_ASSERT_EQUAL_FLOAT(250, st["configfile"]["settings"]["stepper_z"]["position_max"].as<float>());
  TEST_ASSERT_TRUE(st["configfile"]["settings"]["gcode_macro cancel_print"].is<JsonObject>());
}

void test_jsonrpc_errors_and_batches() {
  Rig r;
  r.svc.ws_open(1);
  JsonDocument nf = r.call(1, "no.such.method");
  TEST_ASSERT_EQUAL(-32601, nf["error"]["code"].as<int>());
  TEST_ASSERT_EQUAL_STRING("Method not found", nf["error"]["message"]);
  JsonDocument pe = parse(r.svc.ws_message(1, "{not json"));
  TEST_ASSERT_EQUAL(-32700, pe["error"]["code"].as<int>());
  TEST_ASSERT_TRUE(pe["id"].isNull());
  // A batch gets an array of replies, one per request with an id.
  std::string batch =
      "[{\"jsonrpc\":\"2.0\",\"method\":\"server.webcams.list\",\"id\":7},"
      "{\"jsonrpc\":\"2.0\",\"method\":\"server.info\"},"
      "{\"jsonrpc\":\"2.0\",\"method\":\"nope\",\"id\":9}]";
  JsonDocument b = parse(r.svc.ws_message(1, batch));
  TEST_ASSERT_TRUE(b.is<JsonArray>());
  TEST_ASSERT_EQUAL(2, b.size());
  TEST_ASSERT_EQUAL(7, b[0]["id"].as<int>());
  TEST_ASSERT_EQUAL(9, b[1]["id"].as<int>());
  TEST_ASSERT_EQUAL(-32601, b[1]["error"]["code"].as<int>());
}

void test_klippy_states_are_notified() {
  Rig r;
  r.svc.ws_open(1);
  r.step();
  TEST_ASSERT_EQUAL_STRING("startup", r.result(1, "server.info")["result"]["klippy_state"]);
  r.ready();
  TEST_ASSERT_EQUAL(1, r.notes(1, "notify_klippy_ready").size());
  r.m.unplugged = true;  // the printer goes away; Halyard notices and reconnects
  r.link.reconnect();
  r.run_until([] { return false; }, 100);
  TEST_ASSERT_EQUAL(1, r.notes(1, "notify_klippy_disconnected").size());
  r.m.unplugged = false;
  TEST_ASSERT_TRUE(r.run_until([&] { return r.link.state() == LinkState::Ready; }, 10000));
  r.run_until([] { return false; }, 10);
  TEST_ASSERT_EQUAL(2, r.notes(1, "notify_klippy_ready").size());
}

void test_status_updates_are_deltas() {
  Rig r;
  r.svc.ws_open(1);
  r.ready();
  r.result(1, "printer.objects.subscribe",
           "{\"objects\":{\"extruder\":[\"temperature\",\"target\"],\"heater_bed\":null}}");
  size_t before = r.notes(1, "notify_status_update").size();
  r.run_until([] { return false; }, 1000);
  TEST_ASSERT_EQUAL(before, r.notes(1, "notify_status_update").size());  // nothing changed
  // A target set at the printer shows up as a delta with only what changed.
  r.result(1, "printer.gcode.script", "{\"script\":\"SET_HEATER_TEMPERATURE HEATER=extruder TARGET=45\"}");
  TEST_ASSERT_EQUAL(45, r.m.hotend_target);
  bool seen = r.run_until([&] {
    for (auto& n : r.notes(1, "notify_status_update"))
      if (n["params"][0]["extruder"]["target"].as<int>() == 45) return true;
    return false;
  }, 5000);
  TEST_ASSERT_TRUE(seen);
  for (auto& n : r.notes(1, "notify_status_update")) {
    JsonObject diff = n["params"][0];
    TEST_ASSERT_TRUE(diff["extruder"]["power"].isNull());  // not subscribed
    TEST_ASSERT_TRUE(n["params"][1].is<double>());         // eventtime
  }
}

// ---- files and uploads -----------------------------------------------------------------

void test_mainsail_upload_then_batched_metadata() {
  Rig r;
  r.svc.ws_open(1);
  r.ready();
  Form f;
  std::string body = f.file("Phone Stand.gcode", with_thumbnail(harmless_job(3, 210, 55)))
                         .field("root", "gcodes").done();
  HttpResponse res = r.upload(false, f.type(), body, 333);
  TEST_ASSERT_EQUAL_MESSAGE(201, res.status, res.body.c_str());
  JsonDocument d = parse(res.body);
  TEST_ASSERT_EQUAL_STRING("Phone Stand.gcode", d["item"]["path"]);
  TEST_ASSERT_EQUAL_STRING("create_file", d["action"]);
  TEST_ASSERT_FALSE(d["print_started"].as<bool>());
  auto changed = r.notes(1, "notify_filelist_changed");  // marlin.cfg's, on connecting, aside
  changed.erase(std::remove_if(changed.begin(), changed.end(), [](JsonDocument& n) {
    return n["params"][0]["item"]["root"] != "gcodes";
  }), changed.end());
  TEST_ASSERT_EQUAL(1, changed.size());
  TEST_ASSERT_EQUAL_STRING("create_file", changed[0]["params"][0]["action"]);
  // Mainsail then asks for the metadata in a batch.
  JsonDocument b = parse(r.svc.ws_message(1,
      "[{\"jsonrpc\":\"2.0\",\"method\":\"server.files.metadata\",\"params\":"
      "{\"filename\":\"Phone Stand.gcode\"},\"id\":25}]"));
  JsonObject m = b[0]["result"];
  TEST_ASSERT_EQUAL_FLOAT(3, m["estimated_time"].as<float>());
  TEST_ASSERT_EQUAL_FLOAT(210, m["first_layer_extr_temp"].as<float>());
  TEST_ASSERT_EQUAL_STRING("PrusaSlicer", m["slicer"]);
  TEST_ASSERT_EQUAL_STRING(".thumbs/Phone Stand-16x16.png", m["thumbnails"][0]["relative_path"]);
  // The thumbnail downloads under the URL Mainsail builds, and nothing outside the library does.
  std::string thumb = r.svc.download_path("gcodes/.thumbs/Phone%20Stand-16x16.png");
  TEST_ASSERT_EQUAL_STRING((g_root + "/gcodes/.thumbs/Phone Stand-16x16.png").c_str(), thumb.c_str());
  TEST_ASSERT_TRUE(r.svc.download_path("gcodes/Phone%20Stand.gcode").size() > 0);
  TEST_ASSERT_EQUAL(0, r.svc.download_path("gcodes/../database.json").size());
  TEST_ASSERT_EQUAL(0, r.svc.download_path("gcodes/.meta/Phone Stand.gcode.meta").size());
  TEST_ASSERT_EQUAL(0, r.svc.download_path("config/.theme/default.json").size());
  // A browser saves a download rather than showing it, under the library name.
  TEST_ASSERT_EQUAL_STRING("attachment; filename=\"Phone Stand.gcode\"; "
                           "filename*=UTF-8''Phone%20Stand.gcode",
                           Service::content_disposition(
                               r.svc.download_path("gcodes/Phone%20Stand.gcode")).c_str());
  TEST_ASSERT_EQUAL_STRING("attachment; filename=\"__l _x_.gcode\"; "
                           "filename*=UTF-8''%C3%85l%20%22x%22.gcode",
                           Service::content_disposition("gcodes/\xC3\x85l \"x\".gcode").c_str());
  // The file list, with metadata when asked.
  JsonDocument dir = r.result(1, "server.files.get_directory", "{\"path\":\"gcodes\",\"extended\":true}");
  TEST_ASSERT_EQUAL(1, dir["result"]["files"].size());
  TEST_ASSERT_EQUAL_STRING("Phone Stand.gcode", dir["result"]["files"][0]["filename"]);
  TEST_ASSERT_EQUAL_FLOAT(3, dir["result"]["files"][0]["estimated_time"].as<float>());
  TEST_ASSERT_EQUAL(1, r.result(1, "server.files.list")["result"].size());
}

void test_upload_refusals() {
  Rig r;
  Form f1;
  HttpResponse res = r.upload(false, f1.type(), f1.file("sub/x.gcode", "G28\n").done());
  TEST_ASSERT_EQUAL(400, res.status);
  Form f2;
  res = r.upload(false, f2.type(), f2.field("root", "config").file("x.cfg", "a").done());
  TEST_ASSERT_EQUAL(400, res.status);
  Form f3;
  res = r.upload(true, f3.type(), f3.field("path", "folder").file("x.gcode", "G28\n").done());
  TEST_ASSERT_EQUAL(400, res.status);
  Form f4;
  std::string cut = f4.file("y.gcode", "G28\nG1 X1\n").done();
  res = r.upload(false, f4.type(), cut.substr(0, cut.size() - 30));
  TEST_ASSERT_EQUAL(400, res.status);  // ended early
  res = r.upload(false, "application/json", "{}");
  TEST_ASSERT_EQUAL(400, res.status);
  TEST_ASSERT_EQUAL(0, r.lib.names().size());
  TEST_ASSERT_FALSE(exists(g_root + "/gcodes/y.gcode.part"));
}

void test_rename_and_delete() {
  Rig r;
  r.svc.ws_open(1);
  Form f;
  TEST_ASSERT_EQUAL(201, r.upload(false, f.type(), f.file("a.gcode", with_thumbnail(harmless_job(1))).done()).status);
  JsonDocument mv = r.result(1, "server.files.move", "{\"source\":\"gcodes/a.gcode\",\"dest\":\"gcodes/b.gcode\"}");
  TEST_ASSERT_EQUAL_STRING("move_file", mv["result"]["action"]);
  JsonDocument meta = r.result(1, "server.files.metadata", "{\"filename\":\"b.gcode\"}");
  std::string rel = meta["result"]["thumbnails"][0]["relative_path"];
  TEST_ASSERT_EQUAL_STRING(".thumbs/b-16x16.png", rel.c_str());
  TEST_ASSERT_TRUE(exists(g_root + "/gcodes/" + rel));
  TEST_ASSERT_EQUAL(404, r.call(1, "server.files.metadata", "{\"filename\":\"a.gcode\"}")["error"]["code"].as<int>());
  // Folders do not exist in the library.
  TEST_ASSERT_EQUAL(400, r.call(1, "server.files.post_directory", "{\"path\":\"gcodes/new\"}")["error"]["code"].as<int>());
  // Delete over HTTP, as Mainsail's file manager does it.
  HttpResponse res;
  TEST_ASSERT_TRUE(r.svc.http("DELETE", "/server/files/gcodes/b.gcode", "", "", res));
  TEST_ASSERT_EQUAL_MESSAGE(200, res.status, res.body.c_str());
  TEST_ASSERT_EQUAL(0, r.lib.names().size());
  TEST_ASSERT_FALSE(exists(g_root + "/gcodes/" + rel));
  auto changed = r.notes(1, "notify_filelist_changed");
  TEST_ASSERT_EQUAL_STRING("delete_file", changed.back()["params"][0]["action"]);
}

// ---- printing --------------------------------------------------------------------------

// The slicer's "Upload and Print".
void test_slicer_upload_and_print() {
  Rig r;
  r.svc.ws_open(1);
  r.ready();
  r.result(1, "printer.objects.subscribe",
           "{\"objects\":{\"print_stats\":null,\"virtual_sdcard\":null,\"display_status\":null}}");
  HttpResponse v;
  TEST_ASSERT_TRUE(r.svc.http("GET", "/api/version", "", "", v));
  TEST_ASSERT_TRUE(starts_with(parse(v.body)["text"].as<std::string>(), "OctoPrint"));
  Form f;  // OrcaSlicer's order: print, path, then the file
  std::string body = f.field("print", "true").field("path", "").file("Orca Job.gcode", harmless_job(20, 200, 50)).done();
  HttpResponse res = r.upload(true, f.type(), body);
  TEST_ASSERT_EQUAL_MESSAGE(201, res.status, res.body.c_str());
  JsonDocument d = parse(res.body);
  TEST_ASSERT_EQUAL_STRING("Orca Job.gcode", d["files"]["local"]["name"]);
  TEST_ASSERT_TRUE(d["effectivePrint"].as<bool>());
  // Mainsail shows a print from the start, the copy first.
  JsonDocument q = r.result(1, "printer.objects.query", "{\"objects\":{\"print_stats\":null}}");
  TEST_ASSERT_EQUAL_STRING("printing", q["result"]["status"]["print_stats"]["state"]);
  TEST_ASSERT_EQUAL_STRING("Orca Job.gcode", q["result"]["status"]["print_stats"]["filename"]);
  TEST_ASSERT_EQUAL(1, r.notes(1, "notify_history_changed").size());
  TEST_ASSERT_TRUE(r.run_until([&] { return r.printer.status().job == Job::Printing; }, 120000));
  TEST_ASSERT_EQUAL(1, r.count_executed("M24"));
  TEST_ASSERT_EQUAL(200, r.m.hotend_target);  // preheated from the file's metadata
  // Printing: progress arrives as deltas; then it completes.
  TEST_ASSERT_TRUE(r.run_until([&] { return r.printer.status().job == Job::Idle; }, 60000));
  r.run_until([] { return false; }, 300);
  bool progressed = false, completed = false;
  for (auto& n : r.notes(1, "notify_status_update")) {
    float p = n["params"][0]["virtual_sdcard"]["progress"] | 0.0f;
    progressed |= p > 0 && p < 1;
    completed |= n["params"][0]["print_stats"]["state"] == "complete";
  }
  TEST_ASSERT_TRUE(progressed);
  TEST_ASSERT_TRUE(completed);
  // A finished job stays on show, at 100 %, until it is cleared.
  q = r.result(1, "printer.objects.query", "{\"objects\":{\"virtual_sdcard\":[\"progress\"],\"print_stats\":null}}");
  TEST_ASSERT_EQUAL_FLOAT(1, q["result"]["status"]["virtual_sdcard"]["progress"].as<float>());
  TEST_ASSERT_TRUE(q["result"]["status"]["print_stats"]["total_duration"].as<float>() > 19);
  TEST_ASSERT_EQUAL_STRING("Orca Job.gcode", q["result"]["status"]["print_stats"]["filename"]);
  JsonDocument hist = r.result(1, "server.history.list");
  TEST_ASSERT_EQUAL(1, hist["result"]["count"].as<int>());
  TEST_ASSERT_EQUAL_STRING("completed", hist["result"]["jobs"][0]["status"]);
  TEST_ASSERT_EQUAL(1, r.result(1, "server.history.totals")["result"]["job_totals"]["total_jobs"].as<int>());
  // The finished job can be cleared from the status panel.
  r.result(1, "printer.gcode.script", "{\"script\":\"SDCARD_RESET_FILE\"}");
  q = r.result(1, "printer.objects.query", "{\"objects\":{\"print_stats\":[\"state\",\"filename\"]}}");
  TEST_ASSERT_EQUAL_STRING("standby", q["result"]["status"]["print_stats"]["state"]);
  TEST_ASSERT_EQUAL_STRING("", q["result"]["status"]["print_stats"]["filename"]);
}

void test_start_refused_while_printing() {
  // D9: a start while the printer prints is refused, not queued.
  Rig r;
  r.svc.ws_open(1);
  r.ready();
  Form f1, f2;
  TEST_ASSERT_EQUAL(201, r.upload(false, f1.type(), f1.file("one.gcode", harmless_job(5)).done()).status);
  TEST_ASSERT_EQUAL(201, r.upload(false, f2.type(), f2.file("two.gcode", harmless_job(2)).done()).status);
  r.result(1, "printer.print.start", "{\"filename\":\"one.gcode\"}");
  TEST_ASSERT_TRUE(r.run_until([&] { return r.printer.status().job == Job::Printing; }, 120000));
  JsonDocument e = r.call(1, "printer.print.start", "{\"filename\":\"two.gcode\"}");
  TEST_ASSERT_EQUAL(400, e["error"]["code"].as<int>());
  TEST_ASSERT_TRUE(e["error"]["message"].as<std::string>().find("printing") != std::string::npos);
  // Upload & Print during a print stores the file and says why it did not start.
  Form f3;
  HttpResponse res = r.upload(false, f3.type(), f3.file("three.gcode", harmless_job(1)).field("print", "true").done());
  TEST_ASSERT_EQUAL(201, res.status);
  TEST_ASSERT_FALSE(parse(res.body)["print_started"].as<bool>());
  TEST_ASSERT_TRUE(r.console_has(1, "not started"));
  TEST_ASSERT_EQUAL(1, r.count_executed("M28"));
}

void test_pause_resume_cancel() {
  Rig r;
  r.svc.ws_open(1);
  r.ready();
  Form f;
  std::string job = harmless_job(30) + "; filament used [mm] = 500\n";
  TEST_ASSERT_EQUAL(201, r.upload(false, f.type(), f.file("long.gcode", job).done()).status);
  r.result(1, "printer.print.start", "{\"filename\":\"long.gcode\"}");
  TEST_ASSERT_TRUE(r.run_until([&] { return r.printer.status().job == Job::Printing; }, 120000));
  r.result(1, "printer.print.pause");
  JsonDocument q = r.result(1, "printer.objects.query", "{\"objects\":{\"pause_resume\":null,\"print_stats\":null}}");
  TEST_ASSERT_TRUE(q["result"]["status"]["pause_resume"]["is_paused"].as<bool>());
  TEST_ASSERT_EQUAL_STRING("paused", q["result"]["status"]["print_stats"]["state"]);
  r.result(1, "printer.print.resume");
  r.result(1, "printer.print.cancel");  // replied once the printer is idle
  TEST_ASSERT_EQUAL(Job::Idle, r.printer.status().job);
  r.step();
  q = r.result(1, "printer.objects.query", "{\"objects\":{\"print_stats\":[\"state\"]}}");
  TEST_ASSERT_EQUAL_STRING("cancelled", q["result"]["status"]["print_stats"]["state"]);
  JsonDocument h = r.result(1, "server.history.list");
  TEST_ASSERT_EQUAL_STRING("cancelled", h["result"]["jobs"][0]["status"]);
  // How much of the slicer's filament a cancelled job used is unknown.
  TEST_ASSERT_FLOAT_WITHIN(0.01, 0, h["result"]["jobs"][0]["filament_used"].as<float>());
  // The motors are released after the printer's own abort G-code (G28XY) has run.
  TEST_ASSERT_TRUE(r.run_until([&] { return r.count_executed("M84") == 1; }, 5000));
  long home = -1, off = -1;
  for (size_t i = 0; i < r.m.executed.size(); i++) {
    if (starts_with(r.m.executed[i], "G28")) home = (long)i;
    if (starts_with(r.m.executed[i], "M84")) off = (long)i;
  }
  TEST_ASSERT_TRUE(home >= 0 && off > home);
}

// Paused and resumed on the printer's own screen: Marlin's host actions tell, and
// Mainsail's RESUME then works (it was refused as "not paused").
void test_pause_on_printer_screen() {
  Rig r;
  r.svc.ws_open(1);
  r.ready();
  Form f;
  TEST_ASSERT_EQUAL(201, r.upload(false, f.type(), f.file("long.gcode", harmless_job(30)).done()).status);
  r.result(1, "printer.print.start", "{\"filename\":\"long.gcode\"}");
  TEST_ASSERT_TRUE(r.run_until([&] { return r.printer.status().job == Job::Printing; }, 120000));
  r.m.queue.push_back({"M25", false});
  TEST_ASSERT_TRUE(r.run_until([&] { return r.printer.status().job == Job::Paused; }, 5000));
  r.step();
  JsonDocument q = r.result(1, "printer.objects.query", "{\"objects\":{\"pause_resume\":null,\"print_stats\":null}}");
  TEST_ASSERT_TRUE(q["result"]["status"]["pause_resume"]["is_paused"].as<bool>());
  TEST_ASSERT_EQUAL_STRING("paused", q["result"]["status"]["print_stats"]["state"]);
  r.result(1, "printer.print.resume");
  r.step();
  q = r.result(1, "printer.objects.query", "{\"objects\":{\"print_stats\":[\"state\"]}}");
  TEST_ASSERT_EQUAL_STRING("printing", q["result"]["status"]["print_stats"]["state"]);
  // And a resume from the screen after a pause from Mainsail.
  r.result(1, "printer.print.pause");
  r.m.queue.push_back({"M24", false});
  TEST_ASSERT_TRUE(r.run_until([&] { return r.printer.status().job == Job::Printing; }, 5000));
  r.step();
  q = r.result(1, "printer.objects.query", "{\"objects\":{\"print_stats\":[\"state\"]}}");
  TEST_ASSERT_EQUAL_STRING("printing", q["result"]["status"]["print_stats"]["state"]);
}

// The heaters' power, in the objects and in the temperature store's powers.
void test_heater_power() {
  Rig r;
  r.m.hotend_power = 127;
  r.m.bed_power = 0;
  r.svc.ws_open(1);
  r.ready();
  r.run_until([] { return false; }, 3000);
  JsonDocument q = r.result(1, "printer.objects.query", "{\"objects\":{\"extruder\":[\"power\"],\"heater_bed\":[\"power\"]}}");
  TEST_ASSERT_FLOAT_WITHIN(0.001, 1.0, q["result"]["status"]["extruder"]["power"].as<float>());
  TEST_ASSERT_FLOAT_WITHIN(0.001, 0.0, q["result"]["status"]["heater_bed"]["power"].as<float>());
  JsonDocument t = r.result(1, "server.temperature_store");
  JsonArray hp = t["result"]["extruder"]["powers"];
  JsonArray bp = t["result"]["heater_bed"]["powers"];
  TEST_ASSERT_TRUE(hp.size() > 0);
  TEST_ASSERT_EQUAL(hp.size(), t["result"]["extruder"]["temperatures"].size());
  TEST_ASSERT_FLOAT_WITHIN(0.001, 1.0, hp[hp.size() - 1].as<float>());
  TEST_ASSERT_FLOAT_WITHIN(0.001, 0.0, bp[bp.size() - 1].as<float>());
}

// History keeps the file's metadata from the job's start, as Moonraker does: Mainsail's
// History shows the thumbnail, the slicer's estimate and filament from it. A completed job
// used the slicer's filament total (Halyard doesn't count the extrusion as it prints).
void test_history_keeps_metadata() {
  Rig r;
  r.svc.ws_open(1);
  r.ready();
  Form f;
  std::string job = with_thumbnail(harmless_job(2)) + "; filament used [mm] = 1234.5\n";
  TEST_ASSERT_EQUAL(201, r.upload(false, f.type(), f.file("meta.gcode", job).done()).status);
  r.result(1, "printer.print.start", "{\"filename\":\"meta.gcode\"}");
  JsonDocument h = r.result(1, "server.history.list");
  JsonObject m = h["result"]["jobs"][0]["metadata"];
  TEST_ASSERT_EQUAL_FLOAT(2, m["estimated_time"].as<float>());
  TEST_ASSERT_EQUAL_STRING("PrusaSlicer", m["slicer"]);
  TEST_ASSERT_EQUAL_STRING(".thumbs/meta-16x16.png", m["thumbnails"][0]["relative_path"]);
  TEST_ASSERT_EQUAL((int)job.size(), m["size"].as<int>());
  TEST_ASSERT_TRUE(m["modified"].as<double>() > 0);
  TEST_ASSERT_FLOAT_WITHIN(0.01, 0, h["result"]["jobs"][0]["filament_used"].as<float>());
  TEST_ASSERT_TRUE(r.run_until([&] {
    return r.result(1, "server.history.list")["result"]["jobs"][0]["status"] == "completed";
  }, 120000));
  h = r.result(1, "server.history.list");
  TEST_ASSERT_FLOAT_WITHIN(0.01, 1234.5, h["result"]["jobs"][0]["filament_used"].as<float>());
  JsonDocument t = r.result(1, "server.history.totals");
  TEST_ASSERT_FLOAT_WITHIN(0.01, 1234.5, t["result"]["job_totals"]["total_filament_used"].as<float>());
  // The status panel's "print complete" shows it too, until the job is cleared.
  JsonDocument q = r.result(1, "printer.objects.query", "{\"objects\":{\"print_stats\":[\"filament_used\"]}}");
  TEST_ASSERT_FLOAT_WITHIN(0.01, 1234.5, q["result"]["status"]["print_stats"]["filament_used"].as<float>());
  r.result(1, "printer.gcode.script", "{\"script\":\"SDCARD_RESET_FILE\"}");
  q = r.result(1, "printer.objects.query", "{\"objects\":{\"print_stats\":[\"filament_used\"]}}");
  TEST_ASSERT_FLOAT_WITHIN(0.01, 0, q["result"]["status"]["print_stats"]["filament_used"].as<float>());
  // Kept when the file goes.
  r.result(1, "server.files.delete_file", "{\"path\":\"gcodes/meta.gcode\"}");
  h = r.result(1, "server.history.list");
  TEST_ASSERT_FALSE(h["result"]["jobs"][0]["exists"].as<bool>());
  TEST_ASSERT_EQUAL_FLOAT(2, h["result"]["jobs"][0]["metadata"]["estimated_time"].as<float>());
}

void test_cancel_during_copy() {
  Rig r;
  r.svc.ws_open(1);
  r.ready();
  Form f;
  TEST_ASSERT_EQUAL(201, r.upload(false, f.type(), f.file("big.gcode", harmless_job(400, 200, 60)).done()).status);
  r.result(1, "printer.print.start", "{\"filename\":\"big.gcode\"}");
  TEST_ASSERT_TRUE(r.run_until([&] { return r.delivery.progress().bytes > 1000; }, 60000));
  JsonDocument q = r.result(1, "printer.objects.query", "{\"objects\":{\"display_status\":null}}");
  TEST_ASSERT_TRUE(starts_with(q["result"]["status"]["display_status"]["message"].as<std::string>(), "Copying"));
  // Mainsail shows both messages; the progress must not appear twice.
  q = r.result(1, "printer.objects.query", "{\"objects\":{\"print_stats\":[\"message\"],\"motion_report\":null}}");
  TEST_ASSERT_EQUAL_STRING("", q["result"]["status"]["print_stats"]["message"]);
  TEST_ASSERT_EQUAL(0, q["result"]["status"]["motion_report"]["live_velocity"].as<int>());
  r.result(1, "printer.print.cancel");
  TEST_ASSERT_TRUE(r.run_until([&] { return !r.delivery.busy(); }, 30000));
  r.run_until([] { return false; }, 300);
  TEST_ASSERT_EQUAL(0, r.m.hotend_target);  // heaters off again
  TEST_ASSERT_EQUAL(0, r.m.bed_target);
  TEST_ASSERT_EQUAL(0, r.count_executed("M24"));
  q = r.result(1, "printer.objects.query", "{\"objects\":{\"print_stats\":[\"state\"]}}");
  TEST_ASSERT_EQUAL_STRING("cancelled", q["result"]["status"]["print_stats"]["state"]);
}

// ---- Halyard's own: the hand-off's progress and the printer's card ---------------------

void test_handoff_progress_in_halyard_object() {
  Rig r;
  r.svc.ws_open(1);
  r.ready();
  Form f;
  TEST_ASSERT_EQUAL(201, r.upload(false, f.type(), f.file("copy me.gcode", with_thumbnail(harmless_job(300))).done()).status);
  r.result(1, "printer.objects.subscribe", "{\"objects\":{\"halyard\":null}}");
  uint32_t version = r.result(1, "printer.objects.query", "{\"objects\":{\"halyard\":null}}")
                         ["result"]["status"]["halyard"]["card_version"];
  // A copy without a print, as Mainsail's "copy to the printer's card" asks for it.
  r.result(1, "printer.card.copy", "{\"filename\":\"gcodes/copy me.gcode\"}");
  TEST_ASSERT_TRUE(r.run_until([&] { return r.delivery.progress().bytes > 2000; }, 60000));
  r.run_until([] { return false; }, 300);
  JsonDocument q = r.result(1, "printer.objects.query", "{\"objects\":{\"halyard\":null}}");
  JsonObject h = q["result"]["status"]["halyard"]["handoff"];
  TEST_ASSERT_EQUAL_STRING("uploading", h["state"]);
  TEST_ASSERT_EQUAL_STRING("copy me.gcode", h["filename"]);
  TEST_ASSERT_EQUAL_STRING("COPYME~1.GCO", h["printer_name"]);
  TEST_ASSERT_FALSE(h["print"].as<bool>());
  TEST_ASSERT_TRUE(h["bytes"].as<uint32_t>() > 2000 && h["bytes"].as<uint32_t>() < h["total"].as<uint32_t>());
  TEST_ASSERT_TRUE(h["elapsed"].as<double>() > 0);
  // Nothing prints, so the job stays as it was.
  q = r.result(1, "printer.objects.query", "{\"objects\":{\"print_stats\":[\"state\"]}}");
  TEST_ASSERT_EQUAL_STRING("standby", q["result"]["status"]["print_stats"]["state"]);
  // Another copy waits: one hand-off at a time.
  JsonDocument busy = r.call(1, "printer.card.copy", "{\"filename\":\"copy me.gcode\"}");
  TEST_ASSERT_EQUAL(409, busy["error"]["code"].as<int>());
  TEST_ASSERT_TRUE(r.run_until([&] { return !r.delivery.busy(); }, 120000));
  r.run_until([] { return false; }, 1000);  // the card is listed again
  // The subscription saw the progress rise, then the hand-off end and the card change.
  uint32_t last_bytes = 0;
  bool rose = false, idle = false, changed = false;
  for (auto& n : r.notes(1, "notify_status_update")) {
    JsonObject d = n["params"][0]["halyard"];
    if (d.isNull()) continue;
    if (d["handoff"]["state"] == "uploading") {
      uint32_t b = d["handoff"]["bytes"];
      rose |= b > last_bytes && last_bytes > 0;
      last_bytes = b;
    }
    idle |= d["handoff"]["state"] == "idle";
    changed |= !d["card_version"].isNull() && d["card_version"].as<uint32_t>() != version;
  }
  TEST_ASSERT_TRUE(rose);
  TEST_ASSERT_TRUE(idle);
  TEST_ASSERT_TRUE(changed);
  JsonDocument l = r.result(1, "printer.card.list", "{\"refresh\":false}");
  JsonArray files = l["result"]["files"];
  TEST_ASSERT_EQUAL(1, files.size());
  TEST_ASSERT_EQUAL_STRING("COPYME~1.GCO", files[0]["name"]);
  TEST_ASSERT_EQUAL_STRING("copy me.gcode", files[0]["library"]);
  TEST_ASSERT_TRUE(files[0]["current"].as<bool>());
  TEST_ASSERT_TRUE(files[0]["modified"].isNull());  // the printer's no-clock date, left out
  // The library file's metadata, as server.files.metadata has it, for a copy that is current.
  JsonObject meta = files[0]["metadata"];
  TEST_ASSERT_EQUAL_FLOAT(300, meta["estimated_time"].as<float>());
  TEST_ASSERT_EQUAL_STRING("PrusaSlicer", meta["slicer"]);
  TEST_ASSERT_EQUAL(1, meta["thumbnails"].size());
  TEST_ASSERT_TRUE(l["result"]["listed"].as<bool>());
  // A copy can be stopped like a print's copy; nothing was printing, so no job ends.
  Form f2;
  TEST_ASSERT_EQUAL(201, r.upload(false, f2.type(), f2.file("stop me.gcode", harmless_job(300)).done()).status);
  r.result(1, "printer.card.copy", "{\"filename\":\"stop me.gcode\"}");
  TEST_ASSERT_TRUE(r.run_until([&] { return r.delivery.progress().bytes > 2000; }, 60000));
  r.result(1, "printer.print.cancel");
  TEST_ASSERT_TRUE(r.run_until([&] { return !r.delivery.busy(); }, 30000));
  TEST_ASSERT_TRUE(r.console_has(1, "Copy of stop me.gcode cancelled"));
  q = r.result(1, "printer.objects.query", "{\"objects\":{\"print_stats\":[\"state\"]}}");
  TEST_ASSERT_EQUAL_STRING("standby", q["result"]["status"]["print_stats"]["state"]);
  TEST_ASSERT_EQUAL(0, r.count_executed("M24"));
}

// The card as the printer holds it, including files Halyard didn't write, on a full and a
// minimal Marlin. M20, M23 and M30 go out only while the printer is idle.
void test_printer_card_list_print_delete() {
  for (int minimal = 0; minimal < 2; minimal++) {
    FakeMarlin::Options o;
    if (minimal) o.long_filename = o.m20_timestamp = o.autoreport_sd = o.emergency_parser = false;
    Rig r(o);
    r.m.files["3DBENC~1.GCO"] = harmless_job(3);
    r.m.files["CUBE.GCO"] = harmless_job(1);
    r.svc.ws_open(1);
    r.ready();
    TEST_ASSERT_TRUE(r.run_until([&] { return r.count_executed("M20") > 0; }, 5000));  // by itself
    JsonDocument l = r.result(1, "printer.card.list");
    JsonArray files = l["result"]["files"];
    TEST_ASSERT_EQUAL(2, files.size());
    TEST_ASSERT_EQUAL_STRING("3DBENC~1.GCO", files[0]["name"]);
    TEST_ASSERT_EQUAL(harmless_job(3).size(), files[0]["size"].as<size_t>());
    TEST_ASSERT_TRUE(files[0]["library"].isNull());  // not from Halyard
    TEST_ASSERT_FALSE(files[0]["printing"].as<bool>());
    TEST_ASSERT_TRUE(l["result"]["stale"].isNull());
    if (minimal) TEST_ASSERT_TRUE(files[0]["modified"].isNull());
    else TEST_ASSERT_EQUAL_STRING("2025-09-10 13:32", files[0]["modified"]);
    // Only names from the listing: nothing else reaches M23 or M30.
    JsonDocument e = r.call(1, "printer.card.delete", "{\"name\":\"NOPE.GCO\"}");
    TEST_ASSERT_EQUAL(404, e["error"]["code"].as<int>());
    TEST_ASSERT_EQUAL(0, r.count_executed("M30"));

    // Printing one starts it as it is: M23, M24, no copy.
    r.result(1, "printer.card.print", "{\"name\":\"3dbenc~1.gco\"}");
    TEST_ASSERT_EQUAL(Job::Printing, r.printer.status().job);
    TEST_ASSERT_EQUAL(0, r.count_executed("M28"));
    JsonDocument q = r.result(1, "printer.objects.query", "{\"objects\":{\"print_stats\":null}}");
    TEST_ASSERT_EQUAL_STRING("printing", q["result"]["status"]["print_stats"]["state"]);
    TEST_ASSERT_EQUAL_STRING("3DBENC~1.GCO", q["result"]["status"]["print_stats"]["filename"]);
    size_t listed = r.count_executed("M20");
    // During the print: the last listing, with why it is not fresh. M30 would close the
    // job's own file (card.closefile()), so a delete is refused before anything is sent.
    r.run_until([] { return false; }, 1500);
    l = r.result(1, "printer.card.list");
    TEST_ASSERT_EQUAL(2, l["result"]["files"].size());
    TEST_ASSERT_EQUAL_STRING("the printer is printing", l["result"]["stale"]);
    TEST_ASSERT_TRUE(l["result"]["files"][0]["printing"].as<bool>());
    l = r.result(1, "printer.card.list", "{\"refresh\":false}");
    TEST_ASSERT_EQUAL_STRING("the printer is printing", l["result"]["stale"]);
    e = r.call(1, "printer.card.delete", "{\"name\":\"CUBE.GCO\"}");
    TEST_ASSERT_EQUAL(409, e["error"]["code"].as<int>());
    TEST_ASSERT_TRUE(r.console_has(1, "!! Not deleted: the printer is printing"));
    TEST_ASSERT_FALSE(r.printer.remove("CUBE.GCO", nullptr));
    e = r.call(1, "printer.card.print", "{\"name\":\"CUBE.GCO\"}");
    TEST_ASSERT_EQUAL(409, e["error"]["code"].as<int>());
    TEST_ASSERT_EQUAL(listed, r.count_executed("M20"));
    TEST_ASSERT_EQUAL(0, r.count_executed("M30"));
    TEST_ASSERT_EQUAL(1, r.count_executed("M23"));

    TEST_ASSERT_TRUE(r.run_until([&] { return r.printer.status().job == Job::Idle; }, 60000));
    r.run_until([] { return false; }, 300);
    q = r.result(1, "printer.objects.query", "{\"objects\":{\"print_stats\":[\"state\"]}}");
    TEST_ASSERT_EQUAL_STRING("complete", q["result"]["status"]["print_stats"]["state"]);
    // Idle again: a delete goes through, and the list follows.
    r.result(1, "printer.card.delete", "{\"name\":\"CUBE.GCO\"}");
    TEST_ASSERT_EQUAL(0, r.m.files.count("CUBE.GCO"));
    TEST_ASSERT_TRUE(r.console_has(1, "Deleted CUBE.GCO"));
    l = r.result(1, "printer.card.list");
    TEST_ASSERT_EQUAL(1, l["result"]["files"].size());
    TEST_ASSERT_TRUE(l["result"]["stale"].isNull());
    // A selection, as the panel deletes it: one after another, each straight after the last
    // reply, while the card is listed again after each.
    r.m.files["A.GCO"] = harmless_job(1);
    r.m.files["B.GCO"] = harmless_job(1);
    r.result(1, "printer.card.list");
    r.result(1, "printer.card.delete", "{\"name\":\"A.GCO\"}");
    r.result(1, "printer.card.delete", "{\"name\":\"B.GCO\"}");
    TEST_ASSERT_EQUAL(0, r.m.files.count("A.GCO") + r.m.files.count("B.GCO"));
    l = r.result(1, "printer.card.list");
    TEST_ASSERT_EQUAL(1, l["result"]["files"].size());
  }
}

// Marlin 2.1.2.x can't open a file in a folder over serial (diveToFile() leaves the folder's
// name unterminated; found on the test printer, read from Marlin's source). Halyard offers no
// print or delete for one there, and says why. bugfix-2.1.x can.
void test_printer_card_files_in_folders() {
  for (int fixed = 0; fixed < 2; fixed++) {
    FakeMarlin::Options o;
    if (fixed) o.version = "bugfix-2.1.x", o.folder_bug = false;
    Rig r(o);
    r.m.files["CUBE.GCO"] = harmless_job(1);
    r.m.files["~1.HAL/WWW/INDEXH~1.GZ"] = "x";
    r.svc.ws_open(1);
    r.ready();
    JsonDocument l = r.result(1, "printer.card.list");
    JsonArray files = l["result"]["files"];
    TEST_ASSERT_EQUAL(2, files.size());
    TEST_ASSERT_TRUE(files[0]["locked"].isNull());  // CUBE.GCO
    JsonDocument e = r.call(1, "printer.card.delete", "{\"name\":\"~1.HAL/WWW/INDEXH~1.GZ\"}");
    if (fixed) {
      TEST_ASSERT_TRUE(files[1]["locked"].isNull());
      TEST_ASSERT_TRUE(e["error"].isNull());
      TEST_ASSERT_EQUAL(0, r.m.files.count("~1.HAL/WWW/INDEXH~1.GZ"));
      continue;
    }
    TEST_ASSERT_TRUE(std::string(files[1]["locked"] | "").find("folder") != std::string::npos);
    TEST_ASSERT_EQUAL(409, e["error"]["code"].as<int>());
    TEST_ASSERT_TRUE(r.console_has(1, "!! Not deleted: "));
    e = r.call(1, "printer.card.print", "{\"name\":\"~1.HAL/WWW/INDEXH~1.GZ\"}");
    TEST_ASSERT_EQUAL(409, e["error"]["code"].as<int>());
    TEST_ASSERT_EQUAL(0, r.count_executed("M30"));
    TEST_ASSERT_EQUAL(0, r.count_executed("M23"));
    TEST_ASSERT_EQUAL(1, r.m.files.count("~1.HAL/WWW/INDEXH~1.GZ"));
  }
}

// ---- the console -----------------------------------------------------------------------

void test_console() {
  Rig r;
  r.svc.ws_open(1);
  r.ready();
  JsonDocument ok = r.result(1, "printer.gcode.script", "{\"script\":\"M115\"}");
  TEST_ASSERT_EQUAL_STRING("ok", ok["result"]);
  TEST_ASSERT_TRUE(r.console_has(1, "FIRMWARE_NAME"));  // the printer's reply reaches the console
  r.result(1, "printer.gcode.script", "{\"script\":\"SET_HEATER_TEMPERATURE HEATER=heater_bed TARGET=40\\nM105\"}");
  TEST_ASSERT_EQUAL(40, r.m.bed_target);
  TEST_ASSERT_TRUE(r.console_has(1, "T:"));  // M105's own answer is shown
  r.result(1, "printer.gcode.script", "{\"script\":\"TURN_OFF_HEATERS\"}");
  TEST_ASSERT_EQUAL(0, r.m.bed_target);
  JsonDocument unk = r.call(1, "printer.gcode.script", "{\"script\":\"BED_MESH_CALIBRATE\"}");
  TEST_ASSERT_EQUAL(400, unk["error"]["code"].as<int>());
  TEST_ASSERT_TRUE(r.console_has(1, "!! Unknown command"));
  JsonDocument m28 = r.call(1, "printer.gcode.script", "{\"script\":\"M28 X.GCO\"}");
  TEST_ASSERT_EQUAL(400, m28["error"]["code"].as<int>());
  TEST_ASSERT_EQUAL(0, r.count_executed("M28"));
  // The console's backlog, commands and replies.
  JsonDocument store = r.result(1, "server.gcode_store");
  bool cmd = false;
  for (JsonVariant e : store["result"]["gcode_store"].as<JsonArray>())
    cmd |= e["message"] == "M115" && e["type"] == "command";
  TEST_ASSERT_TRUE(cmd);
  // Over HTTP the reply does not wait.
  HttpResponse res;
  TEST_ASSERT_TRUE(r.svc.http("POST", "/printer/gcode/script", "script=M117%20hi", "", res));
  TEST_ASSERT_EQUAL_STRING("ok", parse(res.body)["result"]);
  TEST_ASSERT_TRUE(r.run_until([&] { return r.count_executed("M117 hi") == 1; }, 1000));
}

// ---- database and HTTP routes ----------------------------------------------------------

// ---- calibration macros ----------------------------------------------------------------

static std::string script(const std::string& text) { return "{\"script\":\"" + text + "\"}"; }

static JsonObject query(Rig& r, JsonDocument& d, const std::string& objects) {
  d = r.result(1, "printer.objects.query", "{\"objects\":" + objects + "}");
  return d["result"]["status"];
}

void test_calibration_macros_in_mainsail() {
  Rig r;
  r.svc.ws_open(1);
  r.ready();
  JsonDocument list = r.result(1, "printer.objects.list");
  std::string objs;
  for (JsonVariant o : list["result"]["objects"].as<JsonArray>()) objs += o.as<std::string>() + ",";
  for (const char* m : {"gcode_macro BED_PID_TUNE,", "gcode_macro EXTRUDER_PID_TUNE,",
                        "gcode_macro CALIBRATE_Z_OFFSET,", "manual_probe,"})
    TEST_ASSERT_TRUE_MESSAGE(objs.find(m) != std::string::npos, m);
  JsonDocument d;
  JsonObject st = query(r, d, "{\"gcode_macro BED_PID_TUNE\":null,\"manual_probe\":null,"
                              "\"configfile\":[\"settings\"],\"gcode\":[\"commands\"]}");
  TEST_ASSERT_TRUE(st["gcode_macro BED_PID_TUNE"].is<JsonObject>());
  TEST_ASSERT_FALSE(st["manual_probe"]["is_active"].as<bool>());
  // Mainsail reads the parameters and their defaults from the macro's gcode text.
  std::string g = st["configfile"]["settings"]["gcode_macro bed_pid_tune"]["gcode"].as<std::string>();
  TEST_ASSERT_TRUE_MESSAGE(g.find("{params.TARGET|default(60)|int}") != std::string::npos, g.c_str());
  TEST_ASSERT_TRUE(st["gcode"]["commands"]["CALIBRATE_Z_OFFSET"]["help"].is<const char*>());

  // Without a probe there is no Z offset to calibrate.
  FakeMarlin::Options o;
  o.probe = false;
  Rig n(o);
  n.svc.ws_open(1);
  n.ready();
  JsonDocument l2 = n.result(1, "printer.objects.list");
  std::string objs2;
  for (JsonVariant v : l2["result"]["objects"].as<JsonArray>()) objs2 += v.as<std::string>() + ",";
  TEST_ASSERT_TRUE(objs2.find("gcode_macro BED_PID_TUNE,") != std::string::npos);
  TEST_ASSERT_TRUE(objs2.find("CALIBRATE_Z_OFFSET") == std::string::npos);
  TEST_ASSERT_TRUE(objs2.find("manual_probe") == std::string::npos);
  JsonDocument e = n.call(1, "printer.gcode.script", script("CALIBRATE_Z_OFFSET"));
  TEST_ASSERT_EQUAL(400, e["error"]["code"].as<int>());
  TEST_ASSERT_EQUAL(0, n.m.homes);
}

// The commands after the last one starting with `first`, in the order the printer ran them.
static std::vector<std::string> executed_from(Rig& r, const std::string& first) {
  std::vector<std::string> out;
  for (auto& e : r.m.executed) {
    if (starts_with(e, first.c_str())) out.clear();
    out.push_back(e);
  }
  return out;
}

static bool has_command(Rig& r, const char* name) {
  JsonDocument d;
  return !query(r, d, "{\"gcode\":null}")["gcode"]["commands"][name].isNull();
}

static std::string homed(Rig& r) {
  JsonDocument d;
  return query(r, d, "{\"toolhead\":null}")["toolhead"]["homed_axes"].as<std::string>();
}

// Mainsail's jog and extrude buttons. Marlin moves an unhomed axis anywhere (into the
// frame), so Halyard refuses those moves, as Klipper does.
void test_toolhead_moves_and_homing() {
  Rig r;
  r.svc.ws_open(1);
  r.ready();
  JsonDocument d;
  const char* jog_z =
      "SAVE_GCODE_STATE NAME=_ui_movement\\nG91\\nG1 Z10 F600\\nRESTORE_GCODE_STATE NAME=_ui_movement";
  TEST_ASSERT_EQUAL_STRING("", homed(r).c_str());
  // Unhomed: the whole script is refused before any of it is sent, so no G91 is left behind.
  JsonDocument e = r.call(1, "printer.gcode.script", script(jog_z));
  TEST_ASSERT_EQUAL(400, e["error"]["code"].as<int>());
  TEST_ASSERT_TRUE(starts_with(e["error"]["message"].as<std::string>(), "Must home axis first: Z"));
  TEST_ASSERT_EQUAL(0, r.count_executed("G91"));
  e = r.call(1, "printer.gcode.script", script("G1 X10 Y5"));
  TEST_ASSERT_TRUE(starts_with(e["error"]["message"].as<std::string>(), "Must home axis first: XY"));
  e = r.call(1, "printer.gcode.script", script("G2 I5 J0"));  // an arc moves X and Y unnamed
  TEST_ASSERT_TRUE(starts_with(e["error"]["message"].as<std::string>(), "Must home axis first: XY"));
  TEST_ASSERT_EQUAL(0, r.count_executed("G1 X"));
  TEST_ASSERT_EQUAL(0, r.count_executed("G2"));
  // The extruder needs no homing; nor does a move after a G28 in the same script, though
  // the lines go out together.
  r.result(1, "printer.gcode.script", script("G1 E1 F300"));
  TEST_ASSERT_EQUAL(1, r.count_executed("G1 E1"));
  e = r.call(1, "printer.gcode.script", script("G28 X\\nG1 X10\\nG1 Y10"));
  TEST_ASSERT_TRUE(starts_with(e["error"]["message"].as<std::string>(), "Must home axis first: Y"));
  TEST_ASSERT_EQUAL(0, r.count_executed("G28"));
  r.result(1, "printer.gcode.script", script("G28 X\\nG1 X10"));
  TEST_ASSERT_EQUAL(1, r.count_executed("G1 X10"));
  TEST_ASSERT_EQUAL_STRING("x", homed(r).c_str());
  // G28 homes what it names, or everything; then the jog runs.
  r.result(1, "printer.gcode.script", script("G28 X Y"));
  TEST_ASSERT_EQUAL_STRING("xy", homed(r).c_str());
  r.result(1, "printer.gcode.script", script("G28"));
  TEST_ASSERT_EQUAL_STRING("xyz", homed(r).c_str());
  r.result(1, "printer.gcode.script", script(jog_z));
  std::vector<std::string> ran = executed_from(r, "G91");
  TEST_ASSERT_EQUAL(4, ran.size());
  TEST_ASSERT_EQUAL_STRING("G1 Z10 F600", ran[1].c_str());
  TEST_ASSERT_EQUAL_STRING("G90", ran[2].c_str());
  TEST_ASSERT_EQUAL_STRING("M82", ran[3].c_str());
  // The position, from M114 once the script is done (the fake homes Z to 10).
  TEST_ASSERT_TRUE(r.run_until([&] {
    return query(r, d, "{\"toolhead\":[\"position\"]}")["toolhead"]["position"][2].as<double>() == 10;
  }, 2000));
  TEST_ASSERT_EQUAL(10, query(r, d, "{\"gcode_move\":null}")["gcode_move"]["gcode_position"][2].as<double>());
  // Steppers switched off may be moved by hand: M84 forgets the axes it names, or all.
  r.result(1, "printer.gcode.script", script("M84 X"));
  TEST_ASSERT_EQUAL_STRING("yz", homed(r).c_str());
  r.result(1, "printer.gcode.script", script("M18 E"));
  TEST_ASSERT_EQUAL_STRING("yz", homed(r).c_str());
  r.result(1, "printer.gcode.script", script("M84"));
  TEST_ASSERT_EQUAL_STRING("", homed(r).c_str());
  // Marlin's idle timeout switches them off silently: 120 s after the last move, unless
  // M84 S changed it (which switches nothing off).
  r.result(1, "printer.gcode.script", script("G28"));
  uint32_t homed_at = r.now;
  TEST_ASSERT_TRUE(r.run_until([&] { return homed(r).empty(); }, 125000));
  TEST_ASSERT_UINT32_WITHIN(1000, 120000, r.now - homed_at);
  r.result(1, "printer.gcode.script", script("G28\\nM84 S300"));
  TEST_ASSERT_EQUAL_STRING("xyz", homed(r).c_str());
  r.run_until([] { return false; }, 200000);
  r.result(1, "printer.gcode.script", script("G1 X20"));  // a move starts the clock again
  r.run_until([] { return false; }, 200000);
  TEST_ASSERT_EQUAL_STRING("xyz", homed(r).c_str());
  TEST_ASSERT_TRUE(r.run_until([&] { return homed(r).empty(); }, 101000));
  // M109 and M190 keep the steppers on while they wait, however long the heating takes.
  r.result(1, "printer.gcode.script", script("M84 S120\\nG28"));
  r.m.heat_ms = 150000;  // longer than call() waits for its reply
  r.svc.ws_message(1, "{\"jsonrpc\":\"2.0\",\"method\":\"printer.gcode.script\",\"params\":" +
                          script("M109 S200") + ",\"id\":999}");
  TEST_ASSERT_TRUE(r.run_until([&] { return r.m.busy_until && r.now > r.m.busy_until + 1000; }, 155000));
  TEST_ASSERT_EQUAL_STRING("xyz", homed(r).c_str());
  r.result(1, "printer.gcode.script", script("M104 S0"));
  // A new connection forgets it: the printer may have restarted, with its own timeout.
  r.result(1, "printer.gcode.script", script("G28"));
  r.m.reboot();
  TEST_ASSERT_TRUE(r.run_until([&] { return r.link.state() != LinkState::Ready; }, 5000));
  r.ready();
  TEST_ASSERT_EQUAL_STRING("", query(r, d, "{\"toolhead\":null}")["toolhead"]["homed_axes"]);
  r.result(1, "printer.gcode.script", script("M84 S0"));  // no timeout
  r.result(1, "printer.gcode.script", script("G28"));
  r.run_until([] { return false; }, 130000);
  TEST_ASSERT_EQUAL_STRING("xyz", homed(r).c_str());

  // Not during a print, not even paused: RESTORE would change the job's own modes.
  Form f;
  TEST_ASSERT_EQUAL(201, r.upload(false, f.type(), f.file("job.gcode", harmless_job(5)).done()).status);
  r.result(1, "printer.print.start", "{\"filename\":\"job.gcode\"}");
  TEST_ASSERT_TRUE(r.run_until([&] { return r.printer.status().job == Job::Printing; }, 120000));
  TEST_ASSERT_EQUAL_STRING("xyz", query(r, d, "{\"toolhead\":null}")["toolhead"]["homed_axes"]);
  size_t g91 = r.count_executed("G91");
  e = r.call(1, "printer.gcode.script",
             script("SAVE_GCODE_STATE NAME=_ui_extrude\\nM83\\nG1 E10 F300\\nRESTORE_GCODE_STATE NAME=_ui_extrude"));
  TEST_ASSERT_EQUAL(400, e["error"]["code"].as<int>());
  TEST_ASSERT_EQUAL(0, r.count_executed("M83"));
  TEST_ASSERT_EQUAL(g91, r.count_executed("G91"));
  // A finished print switches the steppers off (SD_FINISHED_RELEASECOMMAND).
  TEST_ASSERT_TRUE(r.run_until([&] { return r.printer.status().job == Job::Idle; }, 60000));
  r.run_until([] { return false; }, 300);
  TEST_ASSERT_EQUAL_STRING("", homed(r).c_str());
}

// Mainsail's Z offset control as babysteps (M290), and its save into the probe's offset.
void test_z_offset_babysteps() {
  Rig r;
  r.svc.ws_open(1);
  r.ready();
  JsonDocument d;
  TEST_ASSERT_TRUE(has_command(r, "SET_GCODE_OFFSET"));
  TEST_ASSERT_TRUE(has_command(r, "Z_OFFSET_APPLY_PROBE"));
  TEST_ASSERT_EQUAL_STRING("probe:z_virtual_endstop",
      query(r, d, "{\"configfile\":null}")["configfile"]["settings"]["stepper_z"]["endstop_pin"]);
  // Marlin ignores babysteps on an unhomed axis, so Halyard says so instead.
  JsonDocument e = r.call(1, "printer.gcode.script", script("SET_GCODE_OFFSET Z_ADJUST=-0.05 "));
  TEST_ASSERT_EQUAL(400, e["error"]["code"].as<int>());
  TEST_ASSERT_EQUAL(0, r.count_executed("M290"));
  r.result(1, "printer.gcode.script", script("G28"));
  r.result(1, "printer.gcode.script", script("SET_GCODE_OFFSET Z_ADJUST=-0.05 MOVE=1"));
  r.result(1, "printer.gcode.script", script("SET_GCODE_OFFSET Z_ADJUST=+0.02 MOVE=1"));
  TEST_ASSERT_EQUAL(1, r.count_executed("M290 P0 Z-0.050"));
  TEST_ASSERT_FLOAT_WITHIN(1e-5, -0.03, r.m.babystep_z);
  TEST_ASSERT_FLOAT_WITHIN(1e-5, -0.9, r.m.probe_z);  // P0: not BABYSTEP_ZPROBE_OFFSET's way
  TEST_ASSERT_FLOAT_WITHIN(1e-5, -0.03,
      query(r, d, "{\"gcode_move\":null}")["gcode_move"]["homing_origin"][2].as<double>());
  // Clear, as Mainsail sends it.
  r.result(1, "printer.gcode.script", script("SET_GCODE_OFFSET Z=0 MOVE=1"));
  TEST_ASSERT_FLOAT_WITHIN(1e-5, 0, r.m.babystep_z);
  TEST_ASSERT_EQUAL(0, query(r, d, "{\"gcode_move\":null}")["gcode_move"]["homing_origin"][2].as<double>());
  // Save: into M851, then SAVE_CONFIG (M500).
  r.result(1, "printer.gcode.script", script("SET_GCODE_OFFSET Z_ADJUST=0.1 MOVE=1"));
  r.result(1, "printer.gcode.script", script("Z_OFFSET_APPLY_PROBE"));
  TEST_ASSERT_FLOAT_WITHIN(1e-5, -0.8, r.m.probe_z);
  TEST_ASSERT_EQUAL(0, query(r, d, "{\"gcode_move\":null}")["gcode_move"]["homing_origin"][2].as<double>());
  TEST_ASSERT_TRUE(query(r, d, "{\"configfile\":null}")["configfile"]["save_config_pending"].as<bool>());
  TEST_ASSERT_TRUE(r.console_has(1, "Probe Z offset -0.800 (it was -0.900)"));
  r.result(1, "printer.gcode.script", script("SAVE_CONFIG"));
  TEST_ASSERT_EQUAL(1, r.m.settings_saved);
  TEST_ASSERT_EQUAL(400, r.call(1, "printer.gcode.script", script("Z_OFFSET_APPLY_ENDSTOP"))["error"]["code"].as<int>());
  TEST_ASSERT_EQUAL(400, r.call(1, "printer.gcode.script", script("SET_GCODE_OFFSET X_ADJUST=1"))["error"]["code"].as<int>());

  // Without babystepping, or without a probe to save into, Mainsail is not offered them.
  FakeMarlin::Options o;
  o.babystep = false;
  Rig n(o);
  n.svc.ws_open(1);
  n.ready();
  TEST_ASSERT_FALSE(has_command(n, "SET_GCODE_OFFSET"));
  TEST_ASSERT_FALSE(has_command(n, "Z_OFFSET_APPLY_PROBE"));
  n.result(1, "printer.gcode.script", script("G28"));
  TEST_ASSERT_EQUAL(400, n.call(1, "printer.gcode.script", script("SET_GCODE_OFFSET Z_ADJUST=0.1"))["error"]["code"].as<int>());
  TEST_ASSERT_EQUAL(0, n.count_executed("M290"));
  FakeMarlin::Options o2;
  o2.probe = false;
  Rig q(o2);
  q.svc.ws_open(1);
  q.ready();
  TEST_ASSERT_TRUE(has_command(q, "SET_GCODE_OFFSET"));
  TEST_ASSERT_FALSE(has_command(q, "Z_OFFSET_APPLY_PROBE"));
  TEST_ASSERT_TRUE(query(q, d, "{\"configfile\":null}")["configfile"]["settings"]["stepper_z"]["endstop_pin"].isNull());
}

// Pressure advance as Marlin's Linear Advance (M900), found by asking.
void test_pressure_advance_as_linear_advance() {
  Rig r;
  r.svc.ws_open(1);
  r.ready();
  JsonDocument d;
  JsonObject ex = query(r, d, "{\"extruder\":null}")["extruder"];
  TEST_ASSERT_FLOAT_WITHIN(1e-5, 0.22, ex["pressure_advance"].as<double>());
  TEST_ASSERT_TRUE(ex["smooth_time"].isNull());  // Marlin has none; Mainsail hides it
  TEST_ASSERT_FLOAT_WITHIN(1e-5, 0.22,
      query(r, d, "{\"configfile\":null}")["configfile"]["settings"]["extruder"]["pressure_advance"].as<double>());
  TEST_ASSERT_TRUE(has_command(r, "SET_PRESSURE_ADVANCE"));
  TEST_ASSERT_FALSE(r.console_has(1, "Advance K"));  // Halyard's own question stays quiet
  // Mainsail's number input sends one value at a time.
  r.result(1, "printer.gcode.script", script("SET_PRESSURE_ADVANCE EXTRUDER=extruder ADVANCE=0.045"));
  TEST_ASSERT_EQUAL(1, r.count_executed("M900 K0.045"));
  TEST_ASSERT_FLOAT_WITHIN(1e-5, 0.045, r.m.advance_k);
  TEST_ASSERT_FLOAT_WITHIN(1e-5, 0.045, query(r, d, "{\"extruder\":null}")["extruder"]["pressure_advance"].as<double>());
  TEST_ASSERT_EQUAL(400, r.call(1, "printer.gcode.script",
      script("SET_PRESSURE_ADVANCE EXTRUDER=extruder SMOOTH_TIME=0.04"))["error"]["code"].as<int>());
  TEST_ASSERT_EQUAL(400, r.call(1, "printer.gcode.script", script("SET_PRESSURE_ADVANCE ADVANCE=11"))["error"]["code"].as<int>());
  // M900 typed in the console is followed too.
  r.result(1, "printer.gcode.script", script("M900 K0.1"));
  TEST_ASSERT_FLOAT_WITHIN(1e-5, 0.1, query(r, d, "{\"extruder\":null}")["extruder"]["pressure_advance"].as<double>());

  // Without LIN_ADVANCE: no pressure_advance, so Halyard's Mainsail shows no panel.
  FakeMarlin::Options o;
  o.lin_advance = false;
  Rig n(o);
  n.svc.ws_open(1);
  n.ready();
  TEST_ASSERT_TRUE(query(n, d, "{\"extruder\":null}")["extruder"]["pressure_advance"].isNull());
  TEST_ASSERT_FALSE(has_command(n, "SET_PRESSURE_ADVANCE"));
  TEST_ASSERT_FALSE(n.console_has(1, "M900"));  // its "Unknown command" is not shown
  TEST_ASSERT_EQUAL(400, n.call(1, "printer.gcode.script", script("SET_PRESSURE_ADVANCE ADVANCE=0.05"))["error"]["code"].as<int>());
  TEST_ASSERT_EQUAL(1, n.count_executed("M900"));  // the question only
}

// Mainsail's Limits panel as Marlin's maximum feedrate (M203) and acceleration (M204).
void test_velocity_limits() {
  Rig r;
  r.svc.ws_open(1);
  r.ready();
  JsonDocument d;
  TEST_ASSERT_TRUE(r.run_until([&] {
    return !query(r, d, "{\"toolhead\":null}")["toolhead"]["max_velocity"].isNull();
  }, 2000));
  JsonObject th = query(r, d, "{\"toolhead\":null}")["toolhead"];
  TEST_ASSERT_EQUAL(500, th["max_velocity"].as<int>());
  TEST_ASSERT_EQUAL(3000, th["max_accel"].as<int>());
  // Marlin has none of these; Halyard's Mainsail hides their fields.
  TEST_ASSERT_TRUE(th["square_corner_velocity"].isNull());
  TEST_ASSERT_TRUE(th["max_accel_to_decel"].isNull());
  TEST_ASSERT_TRUE(th["minimum_cruise_ratio"].isNull());
  TEST_ASSERT_TRUE(has_command(r, "SET_VELOCITY_LIMIT"));
  TEST_ASSERT_FALSE(r.console_has(1, "M203"));  // Halyard's own questions stay quiet
  // Mainsail's number inputs send one value at a time.
  r.result(1, "printer.gcode.script", script("SET_VELOCITY_LIMIT VELOCITY=250"));
  TEST_ASSERT_EQUAL(1, r.count_executed("M203 X250 Y250"));
  r.result(1, "printer.gcode.script", script("SET_VELOCITY_LIMIT ACCEL=1500"));
  TEST_ASSERT_EQUAL(1, r.count_executed("M204 P1500 T1500"));
  TEST_ASSERT_FLOAT_WITHIN(1e-5, 1500, r.m.travel_accel);
  TEST_ASSERT_TRUE(r.run_until([&] {
    JsonObject t = query(r, d, "{\"toolhead\":null}")["toolhead"];
    return t["max_velocity"].as<int>() == 250 && t["max_accel"].as<int>() == 1500;
  }, 2000));
  // The defaults (the panel's reset) stay what the printer had when it connected.
  JsonObject pr = query(r, d, "{\"configfile\":null}")["configfile"]["settings"]["printer"];
  TEST_ASSERT_EQUAL(500, pr["max_velocity"].as<int>());
  TEST_ASSERT_EQUAL(3000, pr["max_accel"].as<int>());
  // Above M201's maximum, Marlin holds it down: said, not hidden.
  r.result(1, "printer.gcode.script", script("SET_VELOCITY_LIMIT ACCEL=5000"));
  TEST_ASSERT_TRUE(r.run_until([&] { return r.console_has(1, "(M201) holds X and Y to 3000"); }, 2000));
  // Set in the console, as a slicer's G-code would, it shows too.
  r.result(1, "printer.gcode.script", script("M203 X300 Y320"));
  TEST_ASSERT_TRUE(r.run_until([&] {
    return query(r, d, "{\"toolhead\":null}")["toolhead"]["max_velocity"].as<int>() == 300;
  }, 2000));
  for (const char* bad : {"SET_VELOCITY_LIMIT SQUARE_CORNER_VELOCITY=5", "SET_VELOCITY_LIMIT ACCEL_TO_DECEL=1000",
                          "SET_VELOCITY_LIMIT MINIMUM_CRUISE_RATIO=0.5", "SET_VELOCITY_LIMIT VELOCITY=0",
                          "SET_VELOCITY_LIMIT ACCEL=fast"})
    TEST_ASSERT_EQUAL_MESSAGE(400, r.call(1, "printer.gcode.script", script(bad))["error"]["code"].as<int>(), bad);
  // Without parameters it reports, as Klipper's does.
  r.result(1, "printer.gcode.script", script("SET_VELOCITY_LIMIT"));
  TEST_ASSERT_TRUE(r.console_has(1, "max_velocity: 300"));

  // LIMITED_MAX_FR_EDITING keeps M203 lower than asked, and Halyard says why.
  FakeMarlin::Options lo;
  lo.max_fr_edit = 400;
  Rig l(lo);
  l.svc.ws_open(1);
  l.ready();
  TEST_ASSERT_TRUE(l.run_until([&] { return has_command(l, "SET_VELOCITY_LIMIT"); }, 2000));
  l.result(1, "printer.gcode.script", script("SET_VELOCITY_LIMIT VELOCITY=800"));
  TEST_ASSERT_TRUE(l.run_until([&] { return l.console_has(1, "maximum feedrate at 400 mm/s"); }, 2000));
  TEST_ASSERT_EQUAL(400, query(l, d, "{\"toolhead\":null}")["toolhead"]["max_velocity"].as<int>());

  // A Marlin that doesn't report its limits has no Limits panel.
  FakeMarlin::Options o;
  o.limits_report = false;
  Rig n(o);
  n.svc.ws_open(1);
  n.ready();
  n.run_until([] { return false; }, 500);
  TEST_ASSERT_TRUE(query(n, d, "{\"toolhead\":null}")["toolhead"]["max_velocity"].isNull());
  TEST_ASSERT_TRUE(query(n, d, "{\"configfile\":null}")["configfile"]["settings"]["printer"]["max_velocity"].isNull());
  TEST_ASSERT_FALSE(has_command(n, "SET_VELOCITY_LIMIT"));
  TEST_ASSERT_EQUAL(400, n.call(1, "printer.gcode.script", script("SET_VELOCITY_LIMIT VELOCITY=200"))["error"]["code"].as<int>());
  TEST_ASSERT_EQUAL(0, n.count_executed("M203 X200 Y200"));
}

// Mainsail's Endstops panel as M119, with Marlin's names; the filament sensor is left out.
void test_query_endstops() {
  FakeMarlin::Options o;
  o.runout = true;
  Rig r(o);
  r.svc.ws_open(1);
  r.ready();
  r.m.triggered = {"z_min", "filament"};
  JsonDocument d = r.result(1, "printer.query_endstops.status");
  JsonObject e = d["result"];
  TEST_ASSERT_EQUAL(4, e.size());
  TEST_ASSERT_EQUAL_STRING("open", e["x_min"] | "");
  TEST_ASSERT_EQUAL_STRING("open", e["y_min"] | "");
  TEST_ASSERT_EQUAL_STRING("TRIGGERED", e["z_min"] | "");
  TEST_ASSERT_EQUAL_STRING("open", e["z_probe"] | "");
  TEST_ASSERT_TRUE(e["filament"].isNull());
  TEST_ASSERT_FALSE(r.console_has(1, "x_min"));  // the report stays out of the console
  // Asked again, it reads again.
  r.m.triggered = {"z_probe"};
  d = r.result(1, "printer.query_endstops.status");
  e = d["result"];
  TEST_ASSERT_EQUAL_STRING("open", e["z_min"] | "");
  TEST_ASSERT_EQUAL_STRING("TRIGGERED", e["z_probe"] | "");
  TEST_ASSERT_EQUAL(2, r.count_executed("M119"));
  // Over HTTP, answered at once: the last report.
  HttpResponse res;
  TEST_ASSERT_TRUE(r.svc.http("GET", "/printer/query_endstops/status", "", "", res));
  d = parse(res.body);
  TEST_ASSERT_EQUAL_STRING("TRIGGERED", d["result"]["z_probe"] | "");

  // Without a probe, there is no z_probe line.
  FakeMarlin::Options np;
  np.probe = false;
  Rig n(np);
  n.svc.ws_open(1);
  n.ready();
  d = n.result(1, "printer.query_endstops.status");
  e = d["result"];
  TEST_ASSERT_EQUAL(3, e.size());
  TEST_ASSERT_TRUE(e["z_probe"].isNull());
}

// Mainsail's speed and flow sliders: M220 and M221 read back as gcode_move's factors, so the
// sliders stay where they were set, and follow the printer's own Tune menu, mid-print too.
void test_speed_and_flow_factors() {
  Rig r;
  r.svc.ws_open(1);
  r.ready();
  JsonDocument d;
  auto factors = [&](double speed, double flow) {
    JsonObject g = query(r, d, "{\"gcode_move\":null}")["gcode_move"];
    return std::fabs(g["speed_factor"].as<double>() - speed) < 1e-6 &&
           std::fabs(g["extrude_factor"].as<double>() - flow) < 1e-6;
  };
  TEST_ASSERT_TRUE(factors(1, 1));
  r.result(1, "printer.gcode.script", script("M220 S150"));
  r.result(1, "printer.gcode.script", script("M221 S95"));
  TEST_ASSERT_TRUE(r.run_until([&] { return factors(1.5, 0.95); }, 2000));
  TEST_ASSERT_FALSE(r.console_has(1, "FR:"));    // Halyard's own questions stay quiet
  TEST_ASSERT_FALSE(r.console_has(1, "Flow:"));
  // Asked in the console, the report shows.
  r.result(1, "printer.gcode.script", script("M221"));
  TEST_ASSERT_TRUE(r.console_has(1, "Flow: 95%"));

  // The printer's Tune menu, during a print: seen within the poll.
  Form f;
  TEST_ASSERT_EQUAL(201, r.upload(false, f.type(), f.file("job.gcode", harmless_job(120)).done()).status);
  r.result(1, "printer.print.start", "{\"filename\":\"job.gcode\"}");
  TEST_ASSERT_TRUE(r.run_until([&] { return r.m.sd_printing; }, 60000));
  r.m.feedrate_pct = 80;
  TEST_ASSERT_TRUE(r.run_until([&] { return factors(0.8, 0.95); }, 30000));

  // A new connection: the printer may have restarted, and is read again.
  Rig n;
  n.svc.ws_open(1);
  n.m.feedrate_pct = 120;
  n.ready();
  JsonObject g = query(n, d, "{\"gcode_move\":null}")["gcode_move"];
  TEST_ASSERT_FLOAT_WITHIN(1e-6, 1.2, g["speed_factor"].as<double>());
}

void test_pid_autotune_and_save_config() {
  Rig r;
  r.svc.ws_open(1);
  r.ready();
  r.result(1, "printer.gcode.script", script("BED_PID_TUNE"));
  TEST_ASSERT_EQUAL(1, r.count_executed("M303 E-1 S60 C8 U1"));
  TEST_ASSERT_TRUE(r.console_has(1, "DEFAULT_BED_KP"));
  JsonDocument d;
  TEST_ASSERT_TRUE(query(r, d, "{\"configfile\":null}")["configfile"]["save_config_pending"].as<bool>());
  r.result(1, "printer.gcode.script", script("EXTRUDER_PID_TUNE TARGET=225"));
  TEST_ASSERT_EQUAL(1, r.count_executed("M303 E0 S225 C8 U1"));
  r.result(1, "printer.gcode.script", script("PID_CALIBRATE HEATER=extruder TARGET=200"));
  TEST_ASSERT_EQUAL(1, r.count_executed("M303 E0 S200 C8 U1"));
  JsonDocument bad = r.call(1, "printer.gcode.script", script("EXTRUDER_PID_TUNE TARGET=400"));
  TEST_ASSERT_EQUAL(400, bad["error"]["code"].as<int>());
  TEST_ASSERT_EQUAL(0, r.m.settings_saved);  // nothing is saved without SAVE_CONFIG
  r.result(1, "printer.gcode.script", script("SAVE_CONFIG"));
  TEST_ASSERT_EQUAL(1, r.m.settings_saved);
  TEST_ASSERT_FALSE(query(r, d, "{\"configfile\":null}")["configfile"]["save_config_pending"].as<bool>());

  // A printer without PIDTEMPBED says so, and that is an error.
  FakeMarlin::Options o;
  o.pid_bed = false;
  Rig n(o);
  n.svc.ws_open(1);
  n.ready();
  JsonDocument e = n.call(1, "printer.gcode.script", script("BED_PID_TUNE"));
  TEST_ASSERT_EQUAL(400, e["error"]["code"].as<int>());
  TEST_ASSERT_TRUE(e["error"]["message"].as<std::string>().find("Bad heater id") != std::string::npos);
  TEST_ASSERT_FALSE(query(n, d, "{\"configfile\":null}")["configfile"]["save_config_pending"].as<bool>());
}

// Stock Marlin 2.1.2.8 (FakeMarlin::stock()): what it lacks is left out, and what it has
// works. Mainsail's panels follow the objects and the console's commands.
void test_stock_marlin_in_mainsail() {
  Rig r(FakeMarlin::stock());
  r.svc.ws_open(1);
  r.ready();
  r.run_until([] { return false; }, 3000);
  JsonDocument list = r.result(1, "printer.objects.list");
  std::string objs;
  for (JsonVariant v : list["result"]["objects"].as<JsonArray>()) objs += v.as<std::string>() + ",";
  TEST_ASSERT_TRUE(objs.find("manual_probe") == std::string::npos);
  TEST_ASSERT_TRUE(objs.find("CALIBRATE_Z_OFFSET") == std::string::npos);
  TEST_ASSERT_TRUE(objs.find("EXTRUDER_PID_TUNE") != std::string::npos);
  JsonDocument d;
  JsonObject st = query(r, d, "{\"extruder\":null,\"toolhead\":null,\"configfile\":null}");
  TEST_ASSERT_TRUE(st["extruder"]["pressure_advance"].isNull());   // no Linear Advance
  TEST_ASSERT_FALSE(st["toolhead"]["max_velocity"].isNull());      // M203/M204 report
  TEST_ASSERT_TRUE(st["configfile"]["settings"]["stepper_z"]["endstop_pin"].isNull());  // no probe
  JsonDocument q = r.result(1, "printer.objects.query", "{\"objects\":{\"gcode\":[\"commands\"]}}");
  JsonObject cmds = q["result"]["status"]["gcode"]["commands"];
  for (const char* c : {"SET_GCODE_OFFSET", "Z_OFFSET_APPLY_PROBE", "SET_PRESSURE_ADVANCE",
                        "SAVE_CONFIG", "M500"})
    TEST_ASSERT_TRUE_MESSAGE(cmds[c].isNull(), c);
  TEST_ASSERT_FALSE(cmds["SET_VELOCITY_LIMIT"].isNull());
  TEST_ASSERT_FALSE(cmds["G28"].isNull());
  // Babysteps are refused, not sent: there is no M290.
  r.result(1, "printer.gcode.script", script("G28"));
  JsonDocument b = r.call(1, "printer.gcode.script", script("SET_GCODE_OFFSET Z_ADJUST=0.05"));
  TEST_ASSERT_EQUAL(400, b["error"]["code"].as<int>());
  TEST_ASSERT_EQUAL(0, r.count_executed("M290"));
}

// Stock Marlin has hotend PID but no EEPROM: the result is in use, and nothing offers to
// save it (M500 doesn't exist). The bed has no PID.
void test_stock_marlin_pid_without_eeprom() {
  Rig r(FakeMarlin::stock());
  r.svc.ws_open(1);
  r.ready();
  r.result(1, "printer.gcode.script", script("EXTRUDER_PID_TUNE TARGET=200"));
  TEST_ASSERT_EQUAL(1, r.count_executed("M303 E0 S200 C8 U1"));
  TEST_ASSERT_TRUE(r.console_has(1, "no EEPROM"));
  TEST_ASSERT_FALSE(r.console_has(1, "Press SAVE CONFIG"));
  JsonDocument d;
  TEST_ASSERT_FALSE(query(r, d, "{\"configfile\":null}")["configfile"]["save_config_pending"].as<bool>());
  r.result(1, "printer.gcode.script", script("SAVE_CONFIG"));
  TEST_ASSERT_TRUE(r.console_has(1, "Nothing to save"));
  TEST_ASSERT_EQUAL(0, r.count_executed("M500"));
  JsonDocument e = r.call(1, "printer.gcode.script", script("BED_PID_TUNE"));
  TEST_ASSERT_EQUAL(400, e["error"]["code"].as<int>());
}

// A print on stock Marlin: ASCII hand-off, 8.3 names, polled card status, no host actions
// and no emergency parser; pause, resume, cancel, and a print to its end with History.
void test_stock_marlin_print() {
  Rig r(FakeMarlin::stock());
  r.svc.ws_open(1);
  r.ready();
  Form f;
  std::string job = harmless_job(30) + "; filament used [mm] = 500\n";
  TEST_ASSERT_EQUAL(201, r.upload(false, f.type(), f.file("long.gcode", job).done()).status);
  r.result(1, "printer.print.start", "{\"filename\":\"long.gcode\"}");
  TEST_ASSERT_TRUE(r.run_until([&] { return r.printer.status().job == Job::Printing; }, 120000));
  r.result(1, "printer.print.pause");
  JsonDocument d;
  TEST_ASSERT_EQUAL_STRING("paused", query(r, d, "{\"print_stats\":null}")["print_stats"]["state"]);
  r.run_until([] { return false; }, 6000);  // polled M27 at a position that stays put
  TEST_ASSERT_EQUAL_STRING("paused", query(r, d, "{\"print_stats\":null}")["print_stats"]["state"]);
  r.result(1, "printer.print.resume");
  r.step();
  TEST_ASSERT_EQUAL_STRING("printing", query(r, d, "{\"print_stats\":null}")["print_stats"]["state"]);
  r.result(1, "printer.print.cancel");
  r.step();
  TEST_ASSERT_EQUAL_STRING("cancelled", query(r, d, "{\"print_stats\":null}")["print_stats"]["state"]);
  Form f2;
  TEST_ASSERT_EQUAL(201, r.upload(false, f2.type(), f2.file("short.gcode", with_thumbnail(harmless_job(2))).done()).status);
  r.result(1, "printer.print.start", "{\"filename\":\"short.gcode\"}");
  TEST_ASSERT_TRUE(r.run_until([&] {
    return r.result(1, "server.history.list")["result"]["jobs"][0]["status"] == "completed";
  }, 120000));
  JsonDocument h = r.result(1, "server.history.list");
  TEST_ASSERT_EQUAL_STRING("short.gcode", h["result"]["jobs"][0]["filename"]);
  TEST_ASSERT_EQUAL(1, h["result"]["jobs"][0]["metadata"]["thumbnails"].size());
}

// The fake's probe triggers 1.25 mm above the bed, but the printer's offset says 0.9.
static void start_z_calibration(Rig& r) {
  r.svc.ws_open(1);
  r.ready();
  r.result(1, "printer.gcode.script", script("CALIBRATE_Z_OFFSET"));
  JsonDocument d;
  JsonObject mp = query(r, d, "{\"manual_probe\":null}")["manual_probe"];
  TEST_ASSERT_TRUE(mp["is_active"].as<bool>());
  TEST_ASSERT_TRUE(mp["z_position_lower"].isNull());
  TEST_ASSERT_EQUAL(1, r.count_executed("G30 X117.5 Y117.5"));
  // The nozzle starts where the probe triggered: above the bed whatever the old offset.
  TEST_ASSERT_FLOAT_WITHIN(0.001, 1.25, r.m.nozzle_height());
  TEST_ASSERT_FALSE(r.m.soft_endstops);  // the nozzle may have to go below Z0
  TEST_ASSERT_FALSE(r.m.leveling_on);
}

void test_z_offset_calibration() {
  Rig r;
  start_z_calibration(r);
  // Nothing else starts meanwhile.
  JsonDocument again = r.call(1, "printer.gcode.script", script("BED_PID_TUNE"));
  TEST_ASSERT_EQUAL(400, again["error"]["code"].as<int>());
  std::string why;
  TEST_ASSERT_FALSE(r.svc.hand_off("x.gcode", true, why));
  TEST_ASSERT_EQUAL_STRING("CALIBRATE_Z_OFFSET is running", why.c_str());
  // Mainsail's dialog: steps, then bisecting between the positions tried.
  for (const char* z : {"-1", "-0.3", "+", "-", "-0.025"})
    r.result(1, "printer.gcode.script", script(std::string("TESTZ Z=") + z));
  JsonDocument d;
  JsonObject mp = query(r, d, "{\"manual_probe\":null}")["manual_probe"];
  TEST_ASSERT_FLOAT_WITHIN(0.0005, -0.3, mp["z_position"].as<float>());
  TEST_ASSERT_FLOAT_WITHIN(0.0005, -0.35, mp["z_position_lower"].as<float>());
  TEST_ASSERT_FLOAT_WITHIN(0.0005, -0.275, mp["z_position_upper"].as<float>());
  TEST_ASSERT_FLOAT_WITHIN(0.001, 0, r.m.nozzle_height());  // on the paper
  int homes = r.m.homes;
  r.result(1, "printer.gcode.script", script("ACCEPT"));
  TEST_ASSERT_FLOAT_WITHIN(0.001, -1.25, r.m.probe_z);
  TEST_ASSERT_EQUAL(homes + 1, r.m.homes);  // Z homed again with the new offset
  TEST_ASSERT_TRUE(r.m.soft_endstops);
  TEST_ASSERT_TRUE(r.m.leveling_on);
  TEST_ASSERT_TRUE(r.console_has(1, "Probe Z offset -1.250 (it was -0.900)"));
  JsonObject st = query(r, d, "{\"manual_probe\":null,\"configfile\":null}");
  TEST_ASSERT_FALSE(st["manual_probe"]["is_active"].as<bool>());
  TEST_ASSERT_TRUE(st["configfile"]["save_config_pending"].as<bool>());
  TEST_ASSERT_EQUAL(0, r.m.settings_saved);
  JsonDocument late = r.call(1, "printer.gcode.script", script("TESTZ Z=-0.1"));
  TEST_ASSERT_EQUAL(400, late["error"]["code"].as<int>());
}

void test_z_offset_calibration_abort() {
  Rig r;
  start_z_calibration(r);
  r.result(1, "printer.gcode.script", script("TESTZ Z=-0.5"));
  r.result(1, "printer.gcode.script", script("ABORT"));
  TEST_ASSERT_FLOAT_WITHIN(0.001, -0.9, r.m.probe_z);
  TEST_ASSERT_TRUE(r.m.nozzle_height() > 5);  // lifted clear
  TEST_ASSERT_TRUE(r.m.soft_endstops);
  TEST_ASSERT_TRUE(r.m.leveling_on);
  JsonDocument d;
  TEST_ASSERT_FALSE(query(r, d, "{\"configfile\":null}")["configfile"]["save_config_pending"].as<bool>());
  std::string why;
  r.svc.hand_off("missing.gcode", true, why);  // refused, but not for the calibration
  TEST_ASSERT_TRUE_MESSAGE(why.find("CALIBRATE") == std::string::npos, why.c_str());
}

void test_database_persists() {
  {
    Rig r;
    r.svc.ws_open(1);
    r.result(1, "server.database.post_item",
             "{\"namespace\":\"mainsail\",\"key\":\"uiSettings.theme\",\"value\":{\"dark\":true}}");
    r.result(1, "server.database.post_item",
             "{\"namespace\":\"mainsail\",\"key\":\"console.history\",\"value\":[\"M115\",\"G28\"]}");
    // Mainsail's first write goes over HTTP.
    HttpResponse res;
    TEST_ASSERT_TRUE(r.svc.http("POST", "/server/database/item", "",
                                "{\"namespace\":\"mainsail\",\"key\":\"initVersion\",\"value\":\"2.19.0\"}", res));
    TEST_ASSERT_EQUAL_MESSAGE(200, res.status, res.body.c_str());
    JsonDocument all = r.result(1, "server.database.get_item", "{\"namespace\":\"mainsail\"}");
    TEST_ASSERT_TRUE(all["result"]["value"]["uiSettings"]["theme"]["dark"].as<bool>());
    JsonDocument one = r.result(1, "server.database.get_item", "{\"namespace\":\"mainsail\",\"key\":\"console.history\"}");
    TEST_ASSERT_EQUAL_STRING("G28", one["result"]["value"][1]);
    r.result(1, "server.database.delete_item", "{\"namespace\":\"mainsail\",\"key\":\"console.history\"}");
    TEST_ASSERT_EQUAL(404, r.call(1, "server.database.get_item",
                                  "{\"namespace\":\"mainsail\",\"key\":\"console.history\"}")["error"]["code"].as<int>());
    r.run_until([] { return false; }, 2500);  // saved a little after the last change
  }
  Rig r2;  // "after a reboot"
  HttpResponse res;
  TEST_ASSERT_TRUE(r2.svc.http("GET", "/server/database/item", "namespace=mainsail", "", res));
  JsonDocument d = parse(res.body);
  TEST_ASSERT_EQUAL_STRING("2.19.0", d["result"]["value"]["initVersion"]);
  TEST_ASSERT_TRUE(d["result"]["value"]["uiSettings"]["theme"]["dark"].as<bool>());
  TEST_ASSERT_TRUE(d["result"]["value"]["console"]["history"].isNull());
  TEST_ASSERT_TRUE(r2.svc.http("GET", "/server/database/list", "", "", res));
  TEST_ASSERT_EQUAL_STRING("mainsail", parse(res.body)["result"]["namespaces"][0]);
}

void test_missing_card_warns_and_refuses_uploads() {
  Rig r;
  r.svc.ws_open(1);
  r.ready();
  TEST_ASSERT_EQUAL(0, r.result(1, "server.info")["result"]["warnings"].size());
  g_card = false;
  // Mainsail shows server.info's warnings under its notification bell.
  JsonDocument info = r.result(1, "server.info");
  JsonArrayConst w = info["result"]["warnings"];
  TEST_ASSERT_EQUAL(1, w.size());
  TEST_ASSERT_EQUAL_STRING(Service::kNoCard, w[0]);
  Form f;
  HttpResponse res = r.upload(true, f.type(), f.file("x.gcode", "M117 hi\n").done());
  g_card = true;
  TEST_ASSERT_EQUAL(503, res.status);
  TEST_ASSERT_NOT_EQUAL(std::string::npos, res.body.find("no SD card"));
  TEST_ASSERT_TRUE(r.svc.http("GET", "/server/files/directory", "path=gcodes", "", res));
  TEST_ASSERT_EQUAL(0, parse(res.body)["result"]["files"].size());
}

static std::string read_all(const std::string& path) {
  std::string out;
  if (FILE* f = fopen(path.c_str(), "rb")) {
    char buf[256];
    size_t n;
    while ((n = fread(buf, 1, sizeof buf, f)) > 0) out.append(buf, n);
    fclose(f);
  }
  return out;
}

static void write_all(const std::string& path, const std::string& text) {
  FILE* f = fopen(path.c_str(), "wb");
  TEST_ASSERT_NOT_NULL(f);
  fwrite(text.data(), 1, text.size(), f);
  fclose(f);
}

// A zip's entries by name, read back through its central directory (as unzip does), with each
// entry's data checked against its CRC. Empty if the archive is malformed.
static std::map<std::string, std::string> unzip(const std::string& z) {
  auto u16 = [&](size_t i) { return (uint32_t)(uint8_t)z[i] | (uint32_t)(uint8_t)z[i + 1] << 8; };
  auto u32 = [&](size_t i) { return u16(i) | u16(i + 2) << 16; };
  std::map<std::string, std::string> out;
  if (z.size() < 22 || u32(z.size() - 22) != 0x06054b50) return {};
  uint32_t n = u16(z.size() - 12), cd = u32(z.size() - 6);
  if (cd + u32(z.size() - 10) != z.size() - 22) return {};
  for (uint32_t i = 0; i < n; i++) {
    if (u32(cd) != 0x02014b50 || u16(cd + 10) != 0) return {};  // stored
    uint32_t crc = u32(cd + 16), size = u32(cd + 24), name_len = u16(cd + 28), local = u32(cd + 42);
    std::string name = z.substr(cd + 46, name_len);
    if (u32(local) != 0x04034b50 || z.substr(local + 30, u16(local + 26)) != name) return {};
    size_t data = local + 30 + u16(local + 26) + u16(local + 28);
    std::string body = z.substr(data, size);
    if (crc32(0, (const Bytef*)body.data(), body.size()) != crc) return {};
    if (u32(data + size) != 0x08074b50 || u32(data + size + 4) != crc) return {};  // descriptor
    out[name] = body;
    cd += 46 + name_len + u16(cd + 30) + u16(cd + 32);
  }
  return out;
}

static std::string read_zip(halyard::ZipStream& zip, size_t chunk) {
  std::string z;
  std::vector<uint8_t> buf(chunk);
  while (size_t n = zip.read(buf.data(), chunk)) z.append((const char*)buf.data(), n);
  return z;
}

// Mainsail downloads several files as one zip: server.files.zip, then a GET of its destination.
void test_download_several_files_as_zip() {
  Rig r;
  r.svc.ws_open(1);
  std::string a = harmless_job(3), b(70000, 'x');
  for (size_t i = 0; i < b.size(); i++) b[i] = (char)(i * 7 % 251);
  write_all(g_root + "/gcodes/Phone Stand.gcode", a);
  write_all(g_root + "/gcodes/\xC3\x85ngbåt.gcode", b);
  write_all(g_root + "/halyard.cfg", "[wifi]\nssid: Home\npassword: sesame-open\n");
  JsonDocument d = r.result(1, "server.files.zip",
      "{\"items\":[\"gcodes/Phone Stand.gcode\",\"gcodes/\xC3\x85ngbåt.gcode\",\"config/halyard.cfg\"],"
      "\"dest\":\"config/gcodes-20260929-230000.zip\"}");
  TEST_ASSERT_EQUAL_STRING("config", d["result"]["destination"]["root"]);
  TEST_ASSERT_EQUAL_STRING("gcodes-20260929-230000.zip", d["result"]["destination"]["path"]);
  TEST_ASSERT_EQUAL_STRING("zip_files", d["result"]["action"]);
  // Nothing was written to the card; the archive is made as it downloads.
  TEST_ASSERT_EQUAL_STRING("", r.svc.download_path("config/gcodes-20260929-230000.zip").c_str());
  TEST_ASSERT_NULL(r.svc.zip_download("config/other.zip").get());
  for (size_t chunk : {7, 8192}) {
    auto zip = r.svc.zip_download("config/gcodes-20260929-230000.zip");
    TEST_ASSERT_NOT_NULL(zip.get());
    auto files = unzip(read_zip(*zip, chunk));
    TEST_ASSERT_FALSE(zip->failed());
    TEST_ASSERT_EQUAL(3, files.size());
    TEST_ASSERT_TRUE(files["Phone Stand.gcode"] == a);
    TEST_ASSERT_TRUE(files["\xC3\x85ngbåt.gcode"] == b);
    TEST_ASSERT_EQUAL_STRING("[wifi]\nssid: Home\npassword: ********\n", files["halyard.cfg"].c_str());
  }
  // A file deleted before the download fails it, rather than giving a zip without it.
  auto zip = r.svc.zip_download("config/gcodes-20260929-230000.zip");
  unlink((g_root + "/gcodes/Phone Stand.gcode").c_str());
  read_zip(*zip, 8192);
  TEST_ASSERT_TRUE(zip->failed());
  // Only files that are there, and only into a root.
  TEST_ASSERT_EQUAL(404, r.call(1, "server.files.zip", "{\"items\":[\"gcodes/Phone Stand.gcode\"]}")["error"]["code"]);
  TEST_ASSERT_EQUAL(404, r.call(1, "server.files.zip", "{\"items\":[\"gcodes/../halyard.cfg\"]}")["error"]["code"]);
  TEST_ASSERT_EQUAL(400, r.call(1, "server.files.zip", "{\"items\":[]}")["error"]["code"]);
  TEST_ASSERT_EQUAL(400, r.call(1, "server.files.zip",
      "{\"items\":[\"config/halyard.cfg\"],\"dest\":\"config/../x.zip\"}")["error"]["code"]);
  // Without a destination, one is named as Moonraker names it.
  d = r.result(1, "server.files.zip", "{\"items\":[\"config/halyard.cfg\"]}");
  TEST_ASSERT_EQUAL_STRING("collection-1790000000.zip", d["result"]["destination"]["path"]);
}

void test_config_root_holds_halyard_cfg() {
  Rig r;
  r.svc.ws_open(1);
  std::string cfg = g_root + "/halyard.cfg";
  write_all(cfg, "[wifi]\nssid: Home\npassword: sesame-open\n");
  // Mainsail's Machine page lists the config root and opens the file in its editor.
  JsonDocument dir = r.result(1, "server.files.get_directory", "{\"path\":\"config\"}");
  TEST_ASSERT_EQUAL(1, dir["result"]["files"].size());
  TEST_ASSERT_EQUAL_STRING("halyard.cfg", dir["result"]["files"][0]["filename"]);
  TEST_ASSERT_EQUAL_STRING("rw", dir["result"]["files"][0]["permissions"]);
  TEST_ASSERT_EQUAL_STRING("rw", dir["result"]["root_info"]["permissions"]);
  // .theme/navi.json puts a link to the update page in Mainsail's sidebar.
  TEST_ASSERT_EQUAL_STRING(".theme", dir["result"]["dirs"][0]["dirname"]);
  JsonDocument theme = r.result(1, "server.files.get_directory", "{\"path\":\"config/.theme\"}");
  TEST_ASSERT_EQUAL_STRING("navi.json", theme["result"]["files"][0]["filename"]);
  std::string navi = r.svc.download_path("config/.theme/navi.json");
  TEST_ASSERT_FALSE(navi.empty());
  TEST_ASSERT_EQUAL_STRING("/halyard/", parse(read_all(navi))[0]["href"]);
  JsonDocument list = r.result(1, "server.files.list", "{\"root\":\"config\"}");
  TEST_ASSERT_EQUAL_STRING("halyard.cfg", list["result"][0]["path"]);
  // Downloaded with the WiFi password masked; never served straight from the card.
  TEST_ASSERT_EQUAL_STRING("", r.svc.download_path("config/halyard.cfg").c_str());
  std::string shown;
  TEST_ASSERT_TRUE(r.svc.download_text("config/halyard.cfg", shown));
  TEST_ASSERT_EQUAL_STRING("[wifi]\nssid: Home\npassword: ********\n", shown.c_str());
  TEST_ASSERT_FALSE(r.svc.download_text("gcodes/x.gcode", shown));
  TEST_ASSERT_EQUAL_STRING("", r.svc.download_path("config/database.json").c_str());
  TEST_ASSERT_EQUAL_STRING("", r.svc.download_path("config/../halyard.cfg").c_str());

  // Its save, as Mainsail 2.19 sends it: the file first, then root, path and checksum.
  Form f;
  std::string body = f.file("halyard.cfg", "[wifi]\nssid: Cabin\npassword: ********\n").field("root", "config")
                         .field("path", "").field("checksum", "abc").done();
  HttpResponse res = r.upload(false, f.type(), body);
  TEST_ASSERT_EQUAL_MESSAGE(201, res.status, res.body.c_str());
  JsonDocument d = parse(res.body);
  TEST_ASSERT_EQUAL_STRING("halyard.cfg", d["item"]["path"]);
  TEST_ASSERT_EQUAL_STRING("config", d["item"]["root"]);
  TEST_ASSERT_EQUAL_STRING("[wifi]\nssid: Cabin\npassword: sesame-open\n", read_all(cfg).c_str());
  auto changed = r.notes(1, "notify_filelist_changed");
  TEST_ASSERT_EQUAL(1, changed.size());
  TEST_ASSERT_EQUAL_STRING("config", changed[0]["params"][0]["item"]["root"]);
  TEST_ASSERT_EQUAL(0, r.lib.names().size());  // not in the library

  // Nothing else goes there, and halyard.cfg goes nowhere else.
  Form f2;
  res = r.upload(false, f2.type(), f2.file("printer.cfg", "x").field("root", "config").done());
  TEST_ASSERT_EQUAL(400, res.status);
  TEST_ASSERT_EQUAL(0, r.lib.names().size());
  Form f3;
  res = r.upload(true, f3.type(), f3.file("halyard.cfg", "[wifi]\nssid: Other\n").done());
  TEST_ASSERT_EQUAL(400, res.status);
  Form f4;
  res = r.upload(false, f4.type(), f4.file("halyard.cfg", "x").field("root", "config").field("path", "sub").done());
  TEST_ASSERT_EQUAL(400, res.status);
  TEST_ASSERT_EQUAL_STRING("[wifi]\nssid: Cabin\npassword: sesame-open\n", read_all(cfg).c_str());
  TEST_ASSERT_EQUAL(400, r.call(1, "server.files.delete_file", "{\"path\":\"config/halyard.cfg\"}")["error"]["code"].as<int>());
  TEST_ASSERT_TRUE(exists(cfg));
}

// Mainsail's Machine page: Marlin as the printer's "mcu", from M115, and Halyard's own
// temperature, which notify_proc_stat_update keeps current.
void test_machine_page_marlin_and_halyard() {
  Rig r;
  r.svc.ws_open(1);
  r.ready();
  JsonDocument list = r.result(1, "printer.objects.list");
  bool listed = false;
  for (JsonVariant v : list["result"]["objects"].as<JsonArray>()) listed |= v == "mcu";
  TEST_ASSERT_TRUE(listed);
  JsonDocument d;
  JsonObject mcu = query(r, d, "{\"mcu\":null}")["mcu"];
  TEST_ASSERT_EQUAL_STRING("Marlin", mcu["app"]);
  TEST_ASSERT_EQUAL_STRING("2.1.2.8", mcu["mcu_version"]);  // without "(fake)", the build
  TEST_ASSERT_EQUAL_STRING("3D Printer", mcu["mcu_constants"]["MCU"]);
  TEST_ASSERT_EQUAL_STRING("1", mcu["mcu_constants"]["EXTRUDER_COUNT"]);
  TEST_ASSERT_EQUAL_STRING("Marlin 2.1.2.8 (fake)", mcu["mcu_constants"]["FIRMWARE_NAME"]);
  TEST_ASSERT_EQUAL(1, mcu["mcu_constants"]["Cap:EEPROM"].as<int>());
  TEST_ASSERT_TRUE(mcu["mcu_constants"]["UUID"].isNull());
  TEST_ASSERT_TRUE(mcu["last_stats"].isNull());  // no load or clock: Mainsail leaves them out
  // The Host row: Halyard's version alone (Mainsail puts "Halyard" before it; Marlin is
  // the mcu row), and what Halyard runs on as its OS.
  JsonDocument info = r.result(1, "printer.info");
  TEST_ASSERT_EQUAL_STRING("Halyard", info["result"]["app"]);
  TEST_ASSERT_EQUAL_STRING("0.5.0", info["result"]["software_version"]);
  JsonDocument si = r.result(1, "machine.system_info");
  TEST_ASSERT_EQUAL_STRING("ESP-IDF v4.4.7, Arduino-ESP32 2.0.17",
                           si["result"]["system_info"]["distribution"]["name"]);

  // Halyard's temperature: in proc_stats, and pushed every 5 s.
  TEST_ASSERT_FLOAT_WITHIN(0.01, 41.5, r.result(1, "machine.proc_stats")["result"]["cpu_temp"].as<float>());
  size_t before = r.notes(1, "notify_proc_stat_update").size();
  g_cpu_temp = 44.25f;
  r.run_until([] { return false; }, 5100);
  auto notes = r.notes(1, "notify_proc_stat_update");
  TEST_ASSERT_TRUE(notes.size() > before);
  TEST_ASSERT_FLOAT_WITHIN(0.01, 44.25, notes.back()["params"][0]["cpu_temp"].as<float>());
  TEST_ASSERT_EQUAL(1, notes.back()["params"][0]["websocket_connections"].as<int>());
  // A board without a sensor sends null, as Moonraker does on a PC without one.
  g_cpu_temp = NAN;
  r.run_until([] { return false; }, 5100);
  TEST_ASSERT_TRUE(r.notes(1, "notify_proc_stat_update").back()["params"][0]["cpu_temp"].isNull());
  TEST_ASSERT_TRUE(r.result(1, "machine.proc_stats")["result"]["cpu_temp"].isNull());
}

// The same on stock Marlin and on bugfix-2.1.x, whose version is a branch name.
void test_machine_page_stock_and_bugfix_marlin() {
  {
    Rig r(FakeMarlin::stock());
    r.ready();
    JsonDocument d;
    JsonObject mcu = query(r, d, "{\"mcu\":null}")["mcu"];
    TEST_ASSERT_EQUAL_STRING("2.1.2.8", mcu["mcu_version"]);
    TEST_ASSERT_EQUAL(0, mcu["mcu_constants"]["Cap:EEPROM"].as<int>());
  }
  FakeMarlin::Options o;
  o.version = "bugfix-2.1.x";
  o.machine = "Ender-3 SKR2";
  Rig r(o);
  r.ready();
  JsonDocument d;
  JsonObject mcu = query(r, d, "{\"mcu\":null}")["mcu"];
  TEST_ASSERT_EQUAL_STRING("bugfix-2.1.x", mcu["mcu_version"]);
  TEST_ASSERT_EQUAL_STRING("Ender-3 SKR2", mcu["mcu_constants"]["MCU"]);
  TEST_ASSERT_EQUAL_STRING("Ender-3 SKR2", r.link.caps().info.at("MACHINE_TYPE").c_str());
  TEST_ASSERT_EQUAL_STRING("github.com/MarlinFirmware/Marlin", r.link.caps().info.at("SOURCE_CODE_URL").c_str());
}

// marlin.cfg: Marlin's settings (M503) beside halyard.cfg, read-only, read again after a
// setting changes. M503's lines stay out of the console.
void test_marlin_cfg() {
  Rig r;
  r.svc.ws_open(1);
  write_all(g_root + "/halyard.cfg", "[wifi]\nssid: Home\n");
  r.ready();
  TEST_ASSERT_EQUAL(1, r.count_executed("M503"));
  JsonDocument dir = r.result(1, "server.files.get_directory", "{\"path\":\"config\"}");
  TEST_ASSERT_EQUAL(2, dir["result"]["files"].size());
  TEST_ASSERT_EQUAL_STRING("halyard.cfg", dir["result"]["files"][0]["filename"]);
  TEST_ASSERT_EQUAL_STRING("marlin.cfg", dir["result"]["files"][1]["filename"]);
  TEST_ASSERT_EQUAL_STRING("r", dir["result"]["files"][1]["permissions"]);
  JsonDocument list = r.result(1, "server.files.list", "{\"root\":\"config\"}");
  TEST_ASSERT_EQUAL_STRING("marlin.cfg", list["result"][1]["path"]);
  std::string text;
  TEST_ASSERT_TRUE(r.svc.download_text("config/marlin.cfg", text));
  TEST_ASSERT_EQUAL(text.size(), dir["result"]["files"][1]["size"].as<size_t>());
  TEST_ASSERT_TRUE(starts_with(text, "# Marlin's settings, as the printer reported them (M503) on "));
  TEST_ASSERT_TRUE(text.find("SAVE CONFIG (M500)") != std::string::npos);
  TEST_ASSERT_TRUE(text.find("\n; Steps per unit:\n  M92 X80.00 Y80.00 Z400.00 E93.00\n") != std::string::npos);
  TEST_ASSERT_TRUE(text.find("  M851 X-33.00 Y-15.00 Z-0.90 ; (mm)\n") != std::string::npos);
  TEST_ASSERT_TRUE(text.find("  G29 W I0 J0 Z0.12000\n") != std::string::npos);
  TEST_ASSERT_TRUE(text.find("echo:") == std::string::npos);
  TEST_ASSERT_FALSE(r.console_has(1, "Steps per unit"));
  TEST_ASSERT_FALSE(r.console_has(1, "M92"));
  TEST_ASSERT_EQUAL_STRING("", r.svc.download_path("config/marlin.cfg").c_str());

  // A setting changed on the console: read again, and Mainsail told the file changed.
  r.result(1, "printer.gcode.script", script("M203 X400"));
  TEST_ASSERT_TRUE(r.run_until([&] { return r.count_executed("M503") == 2; }, 3000));
  r.run_until([] { return false; }, 300);
  TEST_ASSERT_TRUE(r.svc.download_text("config/marlin.cfg", text));
  TEST_ASSERT_TRUE(text.find("  M203 X400.00 Y500.00") != std::string::npos);
  auto changed = r.notes(1, "notify_filelist_changed");
  TEST_ASSERT_TRUE(changed.size() >= 1);
  TEST_ASSERT_EQUAL_STRING("modify_file", changed.back()["params"][0]["action"]);
  TEST_ASSERT_EQUAL_STRING("marlin.cfg", changed.back()["params"][0]["item"]["path"]);
  TEST_ASSERT_EQUAL_STRING("config", changed.back()["params"][0]["item"]["root"]);
  // A command M503 doesn't report changes nothing there.
  r.result(1, "printer.gcode.script", script("M117 hello"));
  r.run_until([] { return false; }, 1000);
  TEST_ASSERT_EQUAL(2, r.count_executed("M503"));
  // Typed on the console, M503's report shows there as usual.
  r.result(1, "printer.gcode.script", script("M503"));
  TEST_ASSERT_TRUE(r.console_has(1, "M92 X80.00"));

  // Never written, renamed or deleted; the editor's save is refused, whichever comes first.
  Form f;
  HttpResponse res = r.upload(false, f.type(), f.file("marlin.cfg", "x").field("root", "config").done());
  TEST_ASSERT_EQUAL(400, res.status);
  TEST_ASSERT_TRUE(res.body.find("read-only") != std::string::npos);
  Form f2;
  res = r.upload(false, f2.type(), f2.field("root", "config").file("marlin.cfg", "x").done());
  TEST_ASSERT_EQUAL(400, res.status);
  TEST_ASSERT_TRUE(res.body.find("read-only") != std::string::npos);
  TEST_ASSERT_EQUAL(0, r.lib.names().size());
  TEST_ASSERT_EQUAL(400, r.call(1, "server.files.delete_file", "{\"path\":\"config/marlin.cfg\"}")["error"]["code"].as<int>());
  TEST_ASSERT_EQUAL(400, r.call(1, "server.files.move", "{\"source\":\"config/marlin.cfg\",\"dest\":\"config/x.cfg\"}")["error"]["code"].as<int>());

  // Downloaded with others as a zip.
  r.result(1, "server.files.zip", "{\"items\":[\"config/marlin.cfg\",\"config/halyard.cfg\"],\"dest\":\"config/c.zip\"}");
  auto zip = r.svc.zip_download("config/c.zip");
  auto files = unzip(read_zip(*zip, 8192));
  TEST_ASSERT_EQUAL(2, files.size());
  TEST_ASSERT_TRUE(files["marlin.cfg"] == text);

  // Read again after a print.
  Form f3;
  TEST_ASSERT_EQUAL(201, r.upload(false, f3.type(), f3.file("short.gcode", harmless_job(2)).done()).status);
  r.result(1, "printer.print.start", "{\"filename\":\"short.gcode\"}");
  TEST_ASSERT_TRUE(r.run_until([&] {
    return r.result(1, "server.history.list")["result"]["jobs"][0]["status"] == "completed";
  }, 120000));
  TEST_ASSERT_TRUE(r.run_until([&] { return r.count_executed("M503") == 4; }, 3000));
}

// Stock Marlin has M503 but no EEPROM, probe or Linear Advance; without M503
// (DISABLE_M503) there is no marlin.cfg, and nothing in the console.
void test_marlin_cfg_stock_and_without_m503() {
  {
    Rig r(FakeMarlin::stock());
    r.svc.ws_open(1);
    r.ready();
    std::string text;
    TEST_ASSERT_TRUE(r.svc.download_text("config/marlin.cfg", text));
    TEST_ASSERT_TRUE(text.find("no EEPROM") != std::string::npos);
    TEST_ASSERT_TRUE(text.find("SAVE CONFIG") == std::string::npos);
    TEST_ASSERT_TRUE(text.find("  M301 P") != std::string::npos);
    TEST_ASSERT_TRUE(text.find("M851") == std::string::npos);
    TEST_ASSERT_TRUE(text.find("M900") == std::string::npos);
    TEST_ASSERT_FALSE(r.console_has(1, "M92"));
  }
  FakeMarlin::Options o = FakeMarlin::stock();
  o.m503 = false;
  Rig r(o);
  r.svc.ws_open(1);
  r.ready();
  TEST_ASSERT_EQUAL(1, r.count_executed("M503"));
  std::string text;
  TEST_ASSERT_FALSE(r.svc.download_text("config/marlin.cfg", text));
  JsonDocument dir = r.result(1, "server.files.get_directory", "{\"path\":\"config\"}");
  TEST_ASSERT_EQUAL(0, dir["result"]["files"].size());
  TEST_ASSERT_FALSE(r.console_has(1, "M503"));
  // And it is not asked again and again.
  r.run_until([] { return false; }, 5000);
  TEST_ASSERT_EQUAL(1, r.count_executed("M503"));
}

void test_restart_reads_config_and_warnings_show() {
  Rig r;
  r.svc.ws_open(1);
  r.ready();
  int restarts = 0;
  r.svc.on_restart = [&] { restarts++; };
  // SAVE & RESTART on a .cfg file sends FIRMWARE_RESTART as G-code.
  r.result(1, "printer.gcode.script", "{\"script\":\"FIRMWARE_RESTART\"}");
  TEST_ASSERT_EQUAL(1, restarts);
  r.svc.set_config_warnings({"halyard.cfg line 3: hostname: use letters; ignored"});
  TEST_ASSERT_TRUE(r.console_has(1, "!! halyard.cfg line 3"));
  JsonDocument info = r.result(1, "server.info");
  TEST_ASSERT_EQUAL(1, info["result"]["warnings"].size());
  TEST_ASSERT_EQUAL_STRING("halyard.cfg line 3: hostname: use letters; ignored", info["result"]["warnings"][0]);
  r.svc.set_config_warnings({});
  JsonDocument info2 = r.result(1, "server.info");
  TEST_ASSERT_EQUAL(0, info2["result"]["warnings"].size());
}

void test_address_on_the_printers_screen() {
  Rig r;
  r.svc.ws_open(1);
  r.svc.show_on_printer("Halyard 192.168.1.23");  // WiFi can be up before the printer
  r.ready();
  TEST_ASSERT_EQUAL(1, r.count_executed("M117 Halyard 192.168.1.23"));
  r.run_until([] { return false; }, 2000);
  TEST_ASSERT_EQUAL(1, r.count_executed("M117 Halyard 192.168.1.23"));  // once
  // A printer that reconnects (it restarted, or was reflashed) has a fresh screen.
  r.link.reconnect();
  r.ready();
  TEST_ASSERT_EQUAL(2, r.count_executed("M117 Halyard 192.168.1.23"));
  // Not over a print's own message: it waits until the print is done.
  Form f;
  TEST_ASSERT_EQUAL(201, r.upload(false, f.type(), f.file("j.gcode", harmless_job(3)).done()).status);
  r.result(1, "printer.print.start", "{\"filename\":\"j.gcode\"}");
  TEST_ASSERT_TRUE(r.run_until([&] { return r.printer.status().job == Job::Printing; }, 120000));
  r.svc.show_on_printer("Halyard: can't join Cabin");
  r.run_until([] { return false; }, 1000);
  TEST_ASSERT_EQUAL(0, r.count_executed("M117 Halyard: can't join Cabin"));
  TEST_ASSERT_TRUE(r.run_until([&] { return r.count_executed("M117 Halyard: can't join Cabin") == 1; }, 60000));
  TEST_ASSERT_EQUAL(Job::Idle, r.printer.status().job);
  // The line is sent with a checksum: '*' and ';' would break it.
  r.svc.show_on_printer("a*b;c\x01");
  TEST_ASSERT_TRUE(r.run_until([&] { return r.count_executed("M117 a b c") == 1; }, 5000));
}

void test_mainsail_in_the_update_manager() {
  std::string installed = "v2.19.0";
  Rig r;
  r.svc.ws_open(1);
  // Without the glue's hooks there is nothing to show.
  TEST_ASSERT_EQUAL(0, r.result(1, "machine.update.status")["result"]["version_info"].size());

  Platform p = Rig::platform(&r.rebooted);
  p.ui_version = [&] { return installed; };
  p.ui_release = "v2.19.0-halyard.1";  // what this firmware ships with (D13)
  Service svc(r.link, r.printer, r.delivery, r.lib, p);
  svc.ws_open(1);
  int checks = 0;
  std::vector<std::string> started;
  svc.on_update_check = [&] { checks++; };
  svc.on_update = [&](const std::string& n, std::string&) { started.push_back(n); return true; };
  auto call = [&](const std::string& method, const std::string& params) {
    std::string out = svc.ws_message(1, "{\"jsonrpc\":\"2.0\",\"method\":\"" + method +
                                           "\",\"params\":" + params + ",\"id\":7}");
    return parse(out);
  };
  auto notes = [&](const std::string& method) {
    std::vector<JsonDocument> out;
    int conn;
    std::string text;
    while (svc.take(conn, text))
      if (text.find("\"" + method + "\"") != std::string::npos) out.push_back(parse(text));
    return out;
  };
  JsonDocument info = call("server.info", "{}");  // Mainsail shows the panel for this component
  bool listed = false;
  for (JsonVariantConst c : info["result"]["components"].as<JsonArrayConst>()) listed |= c == "update_manager";
  TEST_ASSERT_TRUE(listed);
  JsonDocument st = call("machine.update.status", "{}");  // Mainsail's start-up: no check
  TEST_ASSERT_EQUAL(0, checks);
  JsonObject m = st["result"]["version_info"]["mainsail"];
  TEST_ASSERT_EQUAL_STRING("web", m["configured_type"]);
  TEST_ASSERT_EQUAL_STRING("v2.19.0", m["version"]);
  // Halyard's build, not upstream's latest: known without a check.
  TEST_ASSERT_EQUAL_STRING("v2.19.0-halyard.1", m["remote_version"]);
  TEST_ASSERT_EQUAL(0, m["warnings"].size());

  call("machine.update.status", "{\"refresh\":true}");  // "check for updates"
  TEST_ASSERT_EQUAL(1, checks);
  svc.update_checked("cannot reach 192.168.1.20");  // the source did not answer: said, not hidden
  auto refreshed = notes("notify_update_refreshed");
  TEST_ASSERT_EQUAL(1, refreshed.size());
  JsonObject rm = refreshed[0]["params"][0]["version_info"]["mainsail"];
  TEST_ASSERT_EQUAL_STRING("v2.19.0-halyard.1", rm["remote_version"]);
  TEST_ASSERT_EQUAL(1, rm["warnings"].size());
  TEST_ASSERT_TRUE(rm["warnings"][0].as<std::string>().find("cannot reach 192.168.1.20") != std::string::npos);
  svc.update_checked("");  // it answers now
  TEST_ASSERT_EQUAL(0, call("machine.update.status", "{}")["result"]["version_info"]["mainsail"]["warnings"].size());

  // The update button.
  TEST_ASSERT_EQUAL_STRING("ok", call("machine.update.client", "{\"name\":\"mainsail\"}")["result"]);
  TEST_ASSERT_EQUAL(1, started.size());
  TEST_ASSERT_TRUE(call("machine.update.status", "{}")["result"]["busy"].as<bool>());
  TEST_ASSERT_EQUAL(409, call("machine.update.client", "{\"name\":\"mainsail\"}")["error"]["code"].as<int>());
  call("machine.update.status", "{\"refresh\":true}");
  TEST_ASSERT_EQUAL(1, checks);  // not while updating
  TEST_ASSERT_EQUAL(400, call("machine.update.client", "{\"name\":\"klipper\"}")["error"]["code"].as<int>());
  notes("");
  svc.update_progress("mainsail", "Downloading: 50%", false);
  installed = "v2.19.0-halyard.1";
  svc.update_progress("mainsail", "Installed Mainsail v2.19.0-halyard.1", true);
  auto progress = notes("notify_update_response");
  TEST_ASSERT_EQUAL(2, progress.size());
  TEST_ASSERT_EQUAL_STRING("mainsail", progress[0]["params"][0]["application"]);
  TEST_ASSERT_FALSE(progress[0]["params"][0]["complete"].as<bool>());
  TEST_ASSERT_TRUE(progress[1]["params"][0]["complete"].as<bool>());
  JsonDocument dd = call("machine.update.status", "{}");
  JsonObject done = dd["result"]["version_info"]["mainsail"];
  TEST_ASSERT_FALSE(call("machine.update.status", "{}")["result"]["busy"].as<bool>());
  TEST_ASSERT_EQUAL_STRING("v2.19.0-halyard.1", done["version"]);
}

void test_http_routes() {
  Rig r;
  r.ready();
  HttpResponse res;
  TEST_ASSERT_TRUE(r.svc.http("GET", "/server/info", "", "", res));
  TEST_ASSERT_EQUAL_STRING("ready", parse(res.body)["result"]["klippy_state"]);
  TEST_ASSERT_TRUE(r.svc.http("GET", "/printer/objects/query", "extruder=temperature,target&webhooks", "", res));
  JsonDocument q = parse(res.body);
  TEST_ASSERT_TRUE(q["result"]["status"]["extruder"]["target"].is<float>());
  TEST_ASSERT_TRUE(q["result"]["status"]["extruder"]["power"].isNull());
  TEST_ASSERT_EQUAL_STRING("ready", q["result"]["status"]["webhooks"]["state"]);
  TEST_ASSERT_TRUE(r.svc.http("GET", "/server/files/directory", "path=gcodes", "", res));
  TEST_ASSERT_EQUAL(200, res.status);
  TEST_ASSERT_TRUE(r.svc.http("GET", "/server/nothing/here", "", "", res));
  TEST_ASSERT_EQUAL(404, res.status);
  TEST_ASSERT_FALSE(r.svc.http("GET", "/index.html", "", "", res));
  TEST_ASSERT_TRUE(r.svc.http("POST", "/api/login", "", "", res));
  TEST_ASSERT_EQUAL(200, res.status);
  TEST_ASSERT_TRUE(r.svc.http("POST", "/machine/reboot", "", "", res));
  r.run_until([&] { return r.rebooted; }, 1000);
  TEST_ASSERT_TRUE(r.rebooted);
}

// A firmware update restarts Halyard: refused during a copy to the printer (it would be
// lost), allowed otherwise, and a setting changed just before is saved first.
void test_restart_for_update() {
  {
    Rig r;
    r.svc.ws_open(1);
    r.ready();
    std::string why;
    TEST_ASSERT_TRUE(r.svc.can_restart(why));
    Form f;
    TEST_ASSERT_EQUAL(201, r.upload(false, f.type(), f.file("big.gcode", harmless_job(400)).done()).status);
    r.result(1, "printer.print.start", "{\"filename\":\"big.gcode\"}");
    TEST_ASSERT_TRUE(r.run_until([&] { return r.delivery.progress().bytes > 1000; }, 60000));
    TEST_ASSERT_FALSE(r.svc.can_restart(why));
    TEST_ASSERT_TRUE(why.find("copied") != std::string::npos);
    r.result(1, "printer.print.cancel");
    TEST_ASSERT_TRUE(r.run_until([&] { return !r.delivery.busy(); }, 30000));
    TEST_ASSERT_TRUE(r.svc.can_restart(why));
    r.result(1, "server.database.post_item",
             "{\"namespace\":\"mainsail\",\"key\":\"theme\",\"value\":\"light\"}");
    r.svc.reboot_soon();
    TEST_ASSERT_TRUE(r.run_until([&] { return r.rebooted; }, 1000));  // before the 2 s save
  }
  Rig r2;
  HttpResponse res;
  TEST_ASSERT_TRUE(r2.svc.http("GET", "/server/database/item", "namespace=mainsail&key=theme", "", res));
  TEST_ASSERT_EQUAL_STRING("light", parse(res.body)["result"]["value"]);
}

// Halyard restarts (an update) while the printer prints a file it handed off. The new
// Halyard finds the print running before M27 C has named the file: the job must still show
// under its library name, in print_stats and in the history.
void test_print_found_running_gets_its_name() {
  Rig r;
  r.svc.ws_open(1);
  r.ready();
  Form f;
  TEST_ASSERT_EQUAL(201, r.upload(false, f.type(), f.file("long job.gcode", harmless_job(120)).done()).status);
  r.result(1, "printer.print.start", "{\"filename\":\"long job.gcode\"}");
  TEST_ASSERT_TRUE(r.run_until([&] { return r.m.sd_printing; }, 60000));
  r.run_until([] { return false; }, 2000);

  Link l2(r.t);  // the restarted Halyard: new everything, same card and printer
  Printer p2(l2);
  Delivery d2(p2, r.lib);
  bool rebooted = false;
  Service s2(l2, p2, d2, r.lib, Rig::platform(&rebooted));
  s2.begin();
  p2.on_line = [&](const std::string& l) { s2.printer_line(l); };
  s2.ws_open(2);
  auto name = [&] {
    std::string q = s2.ws_message(2, "{\"jsonrpc\":\"2.0\",\"method\":\"printer.objects.query\",\"params\":"
                                     "{\"objects\":{\"print_stats\":[\"filename\"]}},\"id\":1}");
    return parse(q)["result"]["status"]["print_stats"]["filename"].as<std::string>();
  };
  bool named = false;
  for (uint32_t i = 0; i < 20000 && !named; i++) {
    p2.poll(r.now);
    d2.poll(r.now);
    s2.poll(r.now);
    r.m.tick(r.now);
    int conn;
    std::string text;
    while (s2.take(conn, text)) {}
    r.now++;
    if (i % 100 == 0) named = name() == "long job.gcode";
  }
  TEST_ASSERT_TRUE_MESSAGE(named, name().c_str());
  TEST_ASSERT_TRUE(r.m.sd_printing);
  std::string h = s2.ws_message(2, "{\"jsonrpc\":\"2.0\",\"method\":\"server.history.list\",\"params\":{},\"id\":2}");
  TEST_ASSERT_EQUAL_STRING("long job.gcode", parse(h)["result"]["jobs"][0]["filename"]);
}

void test_line_noise_stays_out_of_the_console() {
  // The GEEK's ROM boot log reaches the printer at every reset, and Marlin echoes it back.
  Rig r;
  r.svc.ws_open(1);
  r.svc.printer_line("echo:Unknown command: \"\xe6\xc6\x18\x06\xad\xb5\"");
  r.svc.printer_line("echo:Unknown command: \"M999x\"");
  r.svc.respond("from the printer: \xe6\x18 done");
  r.drain();
  JsonDocument store = r.result(1, "server.gcode_store");
  JsonArray a = store["result"]["gcode_store"];
  TEST_ASSERT_EQUAL(2, a.size());
  TEST_ASSERT_EQUAL_STRING("Unknown command: \"M999x\"", a[0]["message"]);
  TEST_ASSERT_EQUAL_STRING("from the printer: ?? done", a[1]["message"]);
  // Every frame sent is plain ASCII, so it is valid UTF-8 and valid JSON.
  for (auto& f : r.sent[1])
    for (unsigned char c : f) TEST_ASSERT_TRUE(c >= 0x20 && c < 0x7f);
}

int main() {
  UNITY_BEGIN();
  RUN_TEST(test_multipart_any_chunking);
  RUN_TEST(test_multipart_boundary_and_errors);
  RUN_TEST(test_mainsail_init_sequence);
  RUN_TEST(test_jsonrpc_errors_and_batches);
  RUN_TEST(test_klippy_states_are_notified);
  RUN_TEST(test_status_updates_are_deltas);
  RUN_TEST(test_mainsail_upload_then_batched_metadata);
  RUN_TEST(test_upload_refusals);
  RUN_TEST(test_rename_and_delete);
  RUN_TEST(test_slicer_upload_and_print);
  RUN_TEST(test_start_refused_while_printing);
  RUN_TEST(test_pause_resume_cancel);
  RUN_TEST(test_pause_on_printer_screen);
  RUN_TEST(test_heater_power);
  RUN_TEST(test_history_keeps_metadata);
  RUN_TEST(test_cancel_during_copy);
  RUN_TEST(test_handoff_progress_in_halyard_object);
  RUN_TEST(test_printer_card_list_print_delete);
  RUN_TEST(test_printer_card_files_in_folders);
  RUN_TEST(test_console);
  RUN_TEST(test_calibration_macros_in_mainsail);
  RUN_TEST(test_pid_autotune_and_save_config);
  RUN_TEST(test_stock_marlin_in_mainsail);
  RUN_TEST(test_stock_marlin_pid_without_eeprom);
  RUN_TEST(test_stock_marlin_print);
  RUN_TEST(test_z_offset_calibration);
  RUN_TEST(test_z_offset_calibration_abort);
  RUN_TEST(test_database_persists);
  RUN_TEST(test_http_routes);
  RUN_TEST(test_missing_card_warns_and_refuses_uploads);
  RUN_TEST(test_config_root_holds_halyard_cfg);
  RUN_TEST(test_machine_page_marlin_and_halyard);
  RUN_TEST(test_machine_page_stock_and_bugfix_marlin);
  RUN_TEST(test_marlin_cfg);
  RUN_TEST(test_marlin_cfg_stock_and_without_m503);
  RUN_TEST(test_restart_reads_config_and_warnings_show);
  RUN_TEST(test_address_on_the_printers_screen);
  RUN_TEST(test_mainsail_in_the_update_manager);
  RUN_TEST(test_line_noise_stays_out_of_the_console);
  RUN_TEST(test_restart_for_update);
  RUN_TEST(test_print_found_running_gets_its_name);
  RUN_TEST(test_download_several_files_as_zip);
  RUN_TEST(test_toolhead_moves_and_homing);
  RUN_TEST(test_z_offset_babysteps);
  RUN_TEST(test_pressure_advance_as_linear_advance);
  RUN_TEST(test_velocity_limits);
  RUN_TEST(test_query_endstops);
  RUN_TEST(test_speed_and_flow_factors);
  return UNITY_END();
}
